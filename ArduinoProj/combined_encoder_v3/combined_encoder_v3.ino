// Generated by tests/prepare-combined-sketch.py; edit combined_state_sequence.ino then regenerate.
#include <Wire.h>
#ifndef ENCODER_MOTION_H
#define ENCODER_MOTION_H
#include <math.h>

// Encoder-only control math. Units: cm, seconds, PWM normalized to 0..1.
// Calibration targets remain STOP-COMMAND counts, not measured body angles.
namespace EncoderMotion {
inline float clamp(float x, float lo, float hi) {
  return x < lo ? lo : (x > hi ? hi : x);
}
inline float lesser(float a, float b) { return a < b ? a : b; }

// Conditional integration: allow unwinding, but do not integrate further
// into actuator saturation. Call using the complete feedforward + P output.
inline float integrate(float integral, float error, float dt, float ki,
                       float base, float lo, float hi, float limit) {
  float candidate = clamp(integral + error * dt, -limit, limit);
  float output = base + ki * candidate;
  if ((output > hi && error > 0) || (output < lo && error < 0)) return integral;
  return candidate;
}

struct References { float left; float right; };
class Profile {
  float speed;
public:
  Profile() : speed(0) {}
  References step(float left, float right, float targetL, float targetR,
                  float cmPerTick, float cruise, float crawl,
                  float acceleration, float deceleration, float dt) {
    References out = {0, 0};
    if (targetL <= 0 || targetR <= 0) return out;
    float lengthL = targetL * cmPerTick, lengthR = targetR * cmPerTick;
    float longest = lengthL > lengthR ? lengthL : lengthR;
    float ratioL = lengthL / longest, ratioR = lengthR / longest;
    float remainingL = fmaxf(0, targetL - left) * cmPerTick / ratioL;
    float remainingR = fmaxf(0, targetR - right) * cmPerTick / ratioR;
    // Use the lagging wheel's remaining path; never resume a completed wheel.
    float remaining = fmaxf(remainingL, remainingR);
    float allowed = fminf(cruise, fmaxf(crawl, sqrtf(2 * deceleration * remaining)));
    speed = clamp(allowed, fmaxf(0, speed - deceleration * dt), speed + acceleration * dt);
    // Progress difference expressed as equivalent cm on the longer wheel path.
    float mismatch = (left / targetL - right / targetR) * longest;
    float correction = clamp(0.8f * mismatch, -3.0f, 3.0f);
    out.left = left >= targetL ? 0 : clamp(speed * ratioL - correction, 0, cruise);
    out.right = right >= targetR ? 0 : clamp(speed * ratioR + correction, 0, cruise);
    return out;
  }
};

class Wheel {
  unsigned long sampleMs, sampleTicks;
  float velocity, integral;
  bool ready;
public:
  Wheel(unsigned long now) : sampleMs(now), sampleTicks(0), velocity(0), integral(0), ready(false) {}
  float measuredSpeed() const { return velocity; }
  int update(unsigned long now, unsigned long ticks, float reference,
             float cmPerTick, int pwmMax, float ceiling, float feedforwardOffset = 0) {
    unsigned long elapsed = now - sampleMs;
    unsigned long delta = ticks - sampleTicks;
    if (elapsed >= 100 && (delta >= 2 || elapsed >= 200)) {
      float dt = elapsed * 0.001f;
      float measured = delta * cmPerTick / dt;
      velocity = ready ? 0.6f * measured + 0.4f * velocity : measured;
      ready = true;
      float base = feedforwardOffset + (47.5f / 4095.0f) * reference
                 + (30.0f / 4095.0f) * (reference - velocity);
      if (reference > 0)
        integral = integrate(integral, reference - velocity, dt,
                             25.0f / 4095.0f, base, 0, ceiling, 50);
      sampleMs = now;
      sampleTicks = ticks;
    }
    if (reference <= 0) { integral = 0; return 0; }
    float output = feedforwardOffset + (47.5f / 4095.0f) * reference
                 + (30.0f / 4095.0f) * (reference - velocity)
                 + (25.0f / 4095.0f) * integral;
    return (int)lroundf(clamp(output, 0, ceiling) * pwmMax);
  }
};
}
#endif


// =====================================================
// MPU6050
// =====================================================
#define MPU_ADDR 0x68

float gyroZOffset = 0.0f;
float yaw = 0.0f;
float lastGyroZ = 0.0f;
unsigned long previousGyroMicros = 0;

// ถ้าหมุนรถไปทางขวาแล้ว Yaw เป็นค่าบวก ให้ใช้ 1.0
// ถ้าหมุนรถไปทางขวาแล้ว Yaw เป็นค่าลบ ให้ใช้ -1.0
float GYRO_SIGN = -1.0f;

// =====================================================
// ENCODER
// =====================================================
// ทดสอบหมุนมอเตอร์ซ้าย (ENA) เพียงล้อเดียวแล้วพบว่าสัญญาณเข้าที่ pin 2
// ดังนั้น pin 2 คือ encoder ซ้าย และ pin 3 คือ encoder ขวา
#define ENC_L 2
#define ENC_R 3

const float ENCODER_SLOTS_PER_REV = 20.0f;
// นับทั้ง RISING และ FALLING จึงได้ 2 counts ต่อหนึ่งช่อง
const float ENCODER_COUNTS_PER_REV = ENCODER_SLOTS_PER_REV * 2.0f;
const float WHEEL_CIRCUMFERENCE = 22.0f;   // cm
const float CM_PER_TICK = WHEEL_CIRCUMFERENCE
                        / ENCODER_COUNTS_PER_REV;

volatile unsigned long encoderR = 0;
volatile unsigned long encoderL = 0;

// =====================================================
// MOTOR
// =====================================================
const int ENA = 5;
const int IN1 = 9;
const int IN2 = 8;

const int ENB = 10;
const int IN3 = 7;
const int IN4 = 6;

const int PWM_MAX = 4095;

// =====================================================
// CLOSED LOOP SETTINGS
// =====================================================
// error = (encoderR - encoderL) - ค่าความต่างเป้าหมายจาก Calibration
// ถ้าขวามากกว่าเป้าหมาย -> เพิ่ม PWM ซ้าย และลด PWM ขวา
// Dual-edge ทำให้หนึ่ง count เหลือ 0.55 cm จึงลด gain ต่อ count ครึ่งหนึ่ง
// ขวานำ 2 counts (เท่ากับ rising-only เดิม 1 tick) -> correction 0.8 cm/s
const float KP_SYNC_SPEED = 0.4f;
const float MAX_SYNC_SPEED_CM_S = 3.0f;

const char FIRMWARE_REVISION[] =
  "ENCODER_PROFILE_V3_RECALIBRATION_REQUIRED";

// =====================================================
// ROTATION TEST SETTINGS
// =====================================================
// เปลี่ยนเป็น 360.0f เมื่อต้องการคาลิเบรตหมุนครบหนึ่งรอบ
const bool RUN_ROTATION_TEST = true;
// true = ใช้ Gyro เรียนจำนวน Encoder, false = ใช้ Encoder หมุนและใช้ Gyro วัดผลเท่านั้น
const bool ROTATE_USE_GYRO_LEARNING = false;
// ทดสอบหมุนซ้ายรวม 360 องศา
const float ROTATE_TARGET_DEG = 375.0f;
// +1 = หมุนขวา, -1 = หมุนซ้าย
const int ROTATE_DIRECTION = -1;
// จากผลจริง: หมุนขวาแล้วค่า Yaw เป็นลบ
const int RIGHT_TURN_GYRO_SIGN = -1;
const float ROTATE_CRUISE_SPEED_CM_S = 25.0f;
const float ROTATE_MIN_SPEED_CM_S = 10.0f;
const float ROTATE_SLOW_ANGLE_DEG = 30.0f;
const unsigned long ROTATE_SOFT_START_MS = 700;
const float ROTATE_STOP_LOOKAHEAD_SEC = 0.12f;
const int ROTATE_START_KICK_PWM = 1100;
const unsigned long ROTATE_START_KICK_MS = 1000;
const unsigned long ROTATE_WHEEL_START_TIMEOUT_MS = 2000;
const int ROTATE_RUNNING_PWM_FLOOR = 650;
// รอบแรกใช้ PWM โดยตรงให้พ้นแรงเสียดทาน แล้วให้ Gyro เป็นตัวหยุดที่ 360 องศา
// จากการทดสอบจริง PWM 2000 หมุนได้ แต่ 1500 มีเสียงและล้อหยุด
// จึงห้ามลดต่ำกว่า 2000 ตลอดการเรียนมุม 360 องศารอบแรก
const int ROTATE_DIRECT_START_PWM = 2000;
const unsigned long ROTATE_DIRECT_START_MS = 450;
const int ROTATE_DIRECT_CRUISE_PWM = 2000;
const int ROTATE_DIRECT_SLOW_PWM = 2000;
const float ROTATE_DIRECT_SLOW_ANGLE_DEG = 45.0f;
const float KP_ROTATE_COUNT_PWM = 40.0f;
const int MAX_ROTATE_COUNT_PWM_CORRECTION = 400;
// Encoder-only replay ต้องคุมความเร็วด้วย encoder ไม่ใช้ PWM คงที่
// มิฉะนั้นแบตเต็มทำให้ความเร็วและระยะไหลหลังหยุดเปลี่ยนมาก
const float ROTATE_REPLAY_SPEED_CM_S = 25.0f;
const int ROTATE_REPLAY_BASE_PWM = 1800;
// หลังล้อเริ่มหมุนสามารถใช้ PWM ต่ำกว่าค่าออกตัวได้ หากค้างจะมี re-kick
const int ROTATE_REPLAY_MIN_PWM = 1200;
const int ROTATE_REPLAY_MAX_PWM = 2400;
const float KP_ROTATE_REPLAY_SPEED_PWM = 60.0f;
const float KI_ROTATE_REPLAY_SPEED_PWM = 30.0f;
const float MAX_ROTATE_REPLAY_INTEGRAL = 30.0f;
const unsigned long ROTATE_REPLAY_REKICK_MS = 300;
const unsigned long ROTATE_ONE_WHEEL_TIMEOUT_MS = 500;
const unsigned long ROTATE_ACTIVE_BRAKE_MS = 180;
// หมุนขวา: ผล V12 หมุนจริง 367.384 deg ที่คำสั่งหยุด 91/93 counts
// ชดเชยการไหลหลังตัดกำลังแล้วได้จุดสั่งหยุด 360 deg เป็น 89.17/91.13
const float ROTATE_RIGHT_LEFT_TICKS_360 = 89.17f;
const float ROTATE_RIGHT_RIGHT_TICKS_360 = 91.13f;
// V26 หมุนจริง 416.298 deg จึงยังขาด 23.702 deg
// เพิ่มตาม Recommended stop เป็น 113/115 counts ที่เป้าหมาย 440 deg
const float ROTATE_LEFT_LEFT_TICKS_360 = 92.46f;
const float ROTATE_LEFT_RIGHT_TICKS_360 = 94.10f;
const float KP_ROTATE_SYNC_SPEED = 0.50f;
const float MAX_ROTATE_SYNC_SPEED_CM_S = 3.0f;
const float MAX_VALID_ROTATION_GYRO_RATE = 220.0f;
const float MAX_WRONG_DIRECTION_DEG = 10.0f;

// Gyro-learning run: Gyroscope รักษามุมเริ่มต้นและเรียนค่า encoder R-L
// รองรับ movement ได้สูงสุด 6 distance segments ต่อ state
const int MAX_CALIBRATION_SEGMENTS = 6;
const float CALIBRATION_SEGMENT_CM = 100.0f;
const unsigned long SEGMENT_PAUSE_MS = 3000;
const bool PAUSE_AT_CHECKPOINTS = false;

// Gyro สร้าง differential speed reference ให้ PI ของล้อทำตาม
// Yaw บวก = รถเบนขวา -> ลดความเร็วซ้ายและเพิ่มความเร็วขวาเพื่อดึงกลับซ้าย
const float KP_GYRO_HEADING_SPEED = 0.35f; // cm/s ต่อ 1 องศา ต่อหนึ่งล้อ
const float KD_GYRO_RATE_SPEED = 0.10f;    // cm/s ต่อ 1 deg/s ช่วยเบรกก่อนเลยมุม
const float MAX_GYRO_SPEED_CORRECTION = 2.5f;
const float GYRO_HEADING_DEADBAND_DEG = 0.10f;
const float MAX_LEARNING_YAW_DEG = 10.0f;
// จาก V4/V5 ขวาต้องการ PWM เพิ่มราว 120-140 ต่อข้างจึงเริ่มตามซ้ายทัน
// สเกลตามความเร็วเพื่อไม่ให้แรงเกินตอน soft-start และช่วงชะลอ
const float LEARNING_BALANCE_PWM_AT_35_CM_S = 120.0f;
const float MAX_TABLE_PEAK_YAW_DEG = 2.0f;
const float MAX_TABLE_FINAL_YAW_DEG = 1.0f;
const float MAX_TABLE_SIDE_OFFSET_CM = 5.0f;

// Encoder-only replay: Gyro วัดผลเท่านั้น ไม่ได้เข้าวงควบคุมล้อ
const bool USE_GYRO_ASSIST = false;

// PWM trim เป็นศูนย์ในแนวทางนี้ เพราะจะ replay ด้วย cumulative encoder R-L
const float ENCODER_ONLY_PWM_TRIM[MAX_CALIBRATION_SEGMENTS] = {
  0.0f, 0.0f, 0.0f, 0.0f, 0.0f, 0.0f
};

// ค่ากลางจาก Gyro-learning V7 จำนวน 3 รอบ: ทุกครั้งได้ {0, 0, 2, 2}
// เป็น cumulative R-L ที่ checkpoint 100, 200, 300 และ 390 cm
const float ENCODER_TARGET_R_MINUS_L[MAX_CALIBRATION_SEGMENTS] = {
  2.0f, 3.0f, 5.0f, 5.0f, 4.0f, 4.0f
};

// longrangegood ใช้เป้าหมาย R-L = 0 ทุก checkpoint ตามไฟล์ต้นฉบับ
const float LONG_RANGE_ENCODER_TARGET_R_MINUS_L[MAX_CALIBRATION_SEGMENTS] = {
  0.0f, 0.0f, 0.0f, 0.0f, 0.0f, 0.0f
};

enum ForwardProfile {
  SHORT_PATH_PROFILE,
  LONG_RANGE_PROFILE
};

ForwardProfile activeForwardProfile = SHORT_PATH_PROFILE;

// รถกำลังวิ่งตรง ไม่ควรมีอัตราหมุนสูงระดับนี้
// ค่าที่เกินถือเป็นข้อมูล I2C เสียและจะไม่สะสมเข้า Yaw
const float MAX_VALID_GYRO_RATE = 30.0f;

// ถ้ารถหยุดแล้วค่าเฉลี่ยยังเกินค่านี้ แสดงว่า zero bias เลื่อนไประหว่างวิ่ง
// ห้ามนำ Yaw ของรอบนั้นไปสร้างตารางชดเชย
const float MAX_VALID_RESIDUAL_BIAS = 0.20f;

// ตอนวัด residual รถต้องนิ่งจริง ค่าที่สูงกว่านี้เป็นการขยับรถ ไม่ใช่ bias
const float MAX_RESIDUAL_SAMPLE_RATE = 2.0f;

// 50 Hz เพียงพอสำหรับวัดการเบนขณะวิ่งตรง และลดจำนวน I2C transaction
// ถ้า transaction แรกพลาด ให้อ่านซ้ำสั้น ๆ ก่อนนับเป็น failure จริง
const unsigned long GYRO_UPDATE_INTERVAL_US = 20000;
const int GYRO_READ_RETRIES = 3;
const unsigned long GYRO_WARMUP_MS = 5000;
const unsigned long GYRO_CALIBRATION_SETTLE_MS = 500;
const int GYRO_CALIBRATION_SAMPLES = 500;
const unsigned long MOTOR_SOFT_START_MS = 1000;
const unsigned int MAX_GYRO_RECOVERIES_PER_RUN = 3;

// ปิด startup boost หลังพบว่าความช้าของ pulse แรกไม่คงที่ในแต่ละรอบ
// เก็บเวลาของ pulse แรกไว้รายงานอย่างเดียว
const int RIGHT_START_BOOST_PWM = 0;
const unsigned long RIGHT_START_BOOST_MS = 600;

// ชะลอก่อนถึงเป้าหมาย ลดการไหลเกินระยะ
const float SLOW_ZONE_CM = 25.0f;
const float MIN_SLOW_SPEED_CM_S = 25.0f;

// PI คุมความเร็วเฉลี่ยจาก encoder เพื่อชดเชยแรงดันแบตเตอรี่
const unsigned long SPEED_CONTROL_INTERVAL_MS = 200;
float KP_SPEED = 30.0f;
float KI_SPEED = 25.0f;
const float MAX_SPEED_INTEGRAL = 50.0f;

// รอบเรียนรู้ใช้ integral ร่วมเพียงตัวเดียว ไม่ให้สะสมแรงต่างซ้าย-ขวาค้าง
const float KP_LEARNING_SPEED = 30.0f;
const float KI_COMMON_LEARNING_SPEED = 25.0f;
const float MAX_COMMON_SPEED_INTEGRAL = 50.0f;

// จากผลวัดจริง PWM ประมาณ 47.5 ให้ความเร็ว 1 cm/s
// PI จะชดเชยต่อเมื่อแรงดันแบตเตอรี่หรือโหลดเปลี่ยน
const float PWM_PER_CM_S = 47.5f;

// หลังสั่งหยุด รอให้รถหยุดจริงแล้วค่อยเก็บผลสุดท้าย
// ไม่ใช้ Gyroscope แล้ว จึงไม่ต้องรอวัดค่าหลังหยุด
const unsigned long SETTLE_TIME_MS = 500; // retain post-stop counts, including coast
const unsigned long RESIDUAL_MEASUREMENT_TIMEOUT_MS = 1200;
const int RESIDUAL_GYRO_SAMPLES = 100;
const unsigned long MAX_RUN_TIME_MS = 30000;

// =====================================================
// RESULT
// =====================================================
bool testFinished = false;
bool runTimedOut = false;
bool straightStalled = false;
bool motionSettled = true;
int activeSegmentCount = 1;
int movementStateNumber = 0;
float commandedDistanceCM = 0.0f;

unsigned long runTimeMs = 0;
unsigned long gyroIntegrationTimeMs = 0;

float yawAtStopCommand = 0.0f;
float finalYaw = 0.0f;
float finalGyroZ = 0.0f;
unsigned long gyroReadFailures = 0;
unsigned long gyroRetrySuccesses = 0;
unsigned long gyroBusRecoveries = 0;
unsigned long gyroInvalidSamples = 0;
unsigned long gyroResidualRejectedSamples = 0;
unsigned int consecutiveGyroFailures = 0;
bool gyroDisabledForRun = false;
bool gyroResidualBiasValid = false;
bool gyroAvailable = false;
bool rotationGyroRateMode = false;
bool rotationAbortedGyro = false;
bool rotationAbortedWrongDirection = false;
bool rotationAbortedWheelStart = false;
bool rotationAbortedWheelMismatch = false;
bool rotationEncoderReplayMode = false;
float commandedRotationDeg = 0.0f;
int commandedRotationDirection = 1;
unsigned long rotationTargetLeftTicks = 0;
unsigned long rotationTargetRightTicks = 0;
float predictedYawAtStop = 0.0f;
float maxAbsRotationRate = 0.0f;
bool learningAbortedGyro = false;
bool learningAbortedYawLimit = false;
int capturedSegmentCount = 0;
unsigned long gyroReadFailuresAtStop = 0;
unsigned long gyroBusRecoveriesAtStop = 0;
unsigned long gyroInvalidSamplesAtStop = 0;
unsigned long firstLeftTickMs = 0;
unsigned long firstRightTickMs = 0;

unsigned long leftAtStopCommand = 0;
unsigned long rightAtStopCommand = 0;
unsigned long finalEncoderL = 0;
unsigned long finalEncoderR = 0;

float commandedSpeed = 0.0f;
float cruiseSpeedLeft = 0.0f;
float cruiseSpeedRight = 0.0f;

struct SavedStageResult {
  bool ready;
  bool timedOut;
  bool gyroValid;
  int stateNumber;
  float targetDistanceCM;
  unsigned long runTimeMs;
  float yawAtStop;
  float correctedYawAtStop;
  unsigned long leftAtStop;
  unsigned long rightAtStop;
  unsigned long finalLeft;
  unsigned long finalRight;
  float averageSpeedLeft;
  float averageSpeedRight;
};

SavedStageResult firstStageResult = {};

float segmentYaw[MAX_CALIBRATION_SEGMENTS];
float segmentGyroRateAtCheckpoint[MAX_CALIBRATION_SEGMENTS];
float segmentMaxAbsYaw[MAX_CALIBRATION_SEGMENTS];
float segmentTimeSec[MAX_CALIBRATION_SEGMENTS];
unsigned long segmentEncoderL[MAX_CALIBRATION_SEGMENTS];
unsigned long segmentEncoderR[MAX_CALIBRATION_SEGMENTS];
unsigned long checkpointEncoderL[MAX_CALIBRATION_SEGMENTS];
unsigned long checkpointEncoderR[MAX_CALIBRATION_SEGMENTS];
float segmentGyroCorrectionSum[MAX_CALIBRATION_SEGMENTS];
float segmentGyroSpeedCorrectionSum[MAX_CALIBRATION_SEGMENTS];
float segmentLearningBalancePWMSum[MAX_CALIBRATION_SEGMENTS];
unsigned long segmentGyroCorrectionSamples[MAX_CALIBRATION_SEGMENTS];

// =====================================================
// ENCODER ISR
// =====================================================
void ISR_encoderR() {
  encoderR++;
}

void ISR_encoderL() {
  encoderL++;
}

void resetEncoders() {
  noInterrupts();
  encoderL = 0;
  encoderR = 0;
  interrupts();
}

void readEncoders(unsigned long &left, unsigned long &right) {
  noInterrupts();
  left = encoderL;
  right = encoderR;
  interrupts();
}

// =====================================================
// CONVERSION
// =====================================================
unsigned long cmToTicks(float cm) {
  return (unsigned long)lroundf(cm / CM_PER_TICK);
}

unsigned long checkpointTicksForIndex(int checkpointIndex,
                                      float totalDistanceCM) {
  float checkpointCM = (checkpointIndex + 1) * CALIBRATION_SEGMENT_CM;
  checkpointCM = min(checkpointCM, totalDistanceCM);
  return cmToTicks(checkpointCM);
}

int speedToPWM(float speed) {
  speed = constrain(speed, 0.0f, 70.0f);
  return constrain((int)(speed * PWM_PER_CM_S), 0, PWM_MAX);
}

float encoderTargetForSegment(int segment) {
  segment = constrain(segment, 0, MAX_CALIBRATION_SEGMENTS - 1);
  if (activeForwardProfile == LONG_RANGE_PROFILE) {
    return LONG_RANGE_ENCODER_TARGET_R_MINUS_L[segment];
  }
  return ENCODER_TARGET_R_MINUS_L[segment];
}

float desiredRightExtraTicks(float distanceCM) {
  if (distanceCM <= 0.0f) return 0.0f;

  int segment = (int)(distanceCM / CALIBRATION_SEGMENT_CM);
  segment = constrain(segment, 0, activeSegmentCount - 1);

  float segmentStartCM = segment * CALIBRATION_SEGMENT_CM;
  float segmentEndCM = (segment == activeSegmentCount - 1)
                     ? commandedDistanceCM
                     : (segment + 1) * CALIBRATION_SEGMENT_CM;
  float segmentLengthCM = segmentEndCM - segmentStartCM;
  if (segmentLengthCM <= 0.0f) segmentLengthCM = CALIBRATION_SEGMENT_CM;
  float fraction = (distanceCM - segmentStartCM)
                 / segmentLengthCM;
  fraction = constrain(fraction, 0.0f, 1.0f);

  float previousTarget = (segment == 0)
                       ? 0.0f
                       : encoderTargetForSegment(segment - 1);
  float nextTarget = encoderTargetForSegment(segment);
  return previousTarget + (nextTarget - previousTarget) * fraction;
}

// =====================================================
// MPU6050
// =====================================================
void writeMPU(uint8_t reg, uint8_t value) {
  Wire.beginTransmission(MPU_ADDR);
  Wire.write(reg);
  Wire.write(value);
  Wire.endTransmission();
}

uint8_t readMPURegister(uint8_t reg) {
  Wire.beginTransmission(MPU_ADDR);
  Wire.write(reg);
  if (Wire.endTransmission(false) != 0) return 0;

  Wire.requestFrom((uint8_t)MPU_ADDR, (uint8_t)1);
  if (Wire.available()) return Wire.read();
  return 0;
}

bool readGyroZRawOnce(int16_t &rawValue) {
  Wire.beginTransmission(MPU_ADDR);
  Wire.write(0x47); // GYRO_ZOUT_H
  if (Wire.endTransmission(false) != 0) return false;

  uint8_t received = Wire.requestFrom((uint8_t)MPU_ADDR, (uint8_t)2);
  if (received != 2 || Wire.available() < 2) {
    // ล้าง byte ที่ค้างอยู่ ไม่ให้ transaction ถัดไปเสียตาม
    while (Wire.available()) Wire.read();
    return false;
  }

  uint8_t highByte = Wire.read();
  uint8_t lowByte = Wire.read();
  rawValue = (int16_t)(((uint16_t)highByte << 8) | lowByte);
  return true;
}

bool readGyroZRaw(int16_t &rawValue) {
  for (int attempt = 0; attempt < GYRO_READ_RETRIES; attempt++) {
    if (readGyroZRawOnce(rawValue)) {
      if (attempt > 0) gyroRetrySuccesses++;
      return true;
    }

    // เว้นให้บัสกลับสู่สถานะ idle ก่อนลองใหม่
    delayMicroseconds(200);
  }
  return false;
}

bool checkMPU6050() {
  Wire.beginTransmission(MPU_ADDR);
  if (Wire.endTransmission() != 0) return false;

  uint8_t whoAmI = readMPURegister(0x75);
  return (whoAmI == 0x68 || whoAmI == 0x69);
}

void initMPU6050() {
  Wire.begin();
  // 100 kHz ทนต่อสัญญาณรบกวนจากมอเตอร์มากกว่า 400 kHz
  Wire.setClock(100000);
  delay(100);

  if (!checkMPU6050()) {
    // โหมดหลักเป็น Encoder-only จึงไม่ควรค้างทั้งโปรแกรมเมื่อ Gyro หลุด
    gyroAvailable = false;
    gyroDisabledForRun = true;
    return;
  }

  gyroAvailable = true;

  writeMPU(0x6B, 0x00); // Wake up
  delay(100);
  writeMPU(0x1B, 0x00); // Gyro +-250 deg/s, 131 LSB/(deg/s)
  writeMPU(0x1A, 0x05); // DLPF ~10 Hz ลดแรงสั่นจากมอเตอร์
  delay(100);
}

void recoverMPU6050Bus() {
  Wire.end();
  delay(2);
  Wire.begin();
  Wire.setClock(100000);
  delay(2);

  // ตั้งค่าใหม่ เผื่อแรงดันตกจน MPU6050 reset
  writeMPU(0x6B, 0x00);
  writeMPU(0x1B, 0x00);
  writeMPU(0x1A, 0x05);

  consecutiveGyroFailures = 0;
  gyroBusRecoveries++;
}

void calibrateGyro() {
  // ตอนนี้ต้องวางรถนิ่ง
  delay(GYRO_CALIBRATION_SETTLE_MS);

  const int samples = GYRO_CALIBRATION_SAMPLES;
  long total = 0;
  int validSamples = 0;
  int attempts = 0;

  while (validSamples < samples && attempts < samples * 3) {
    int16_t rawValue;
    if (readGyroZRaw(rawValue)) {
      total += rawValue;
      validSamples++;
    }
    attempts++;
    delay(2);
  }

  if (validSamples > 0) {
    gyroZOffset = ((float)total / validSamples) / 131.0f;
  } else {
    gyroZOffset = 0.0f;
  }

  // รายงานเฉพาะ failure ที่เกิดระหว่างการวิ่งและวัดผล
  gyroReadFailures = 0;
  gyroRetrySuccesses = 0;
  gyroBusRecoveries = 0;
  gyroInvalidSamples = 0;
  gyroResidualRejectedSamples = 0;
  gyroReadFailuresAtStop = 0;
  gyroBusRecoveriesAtStop = 0;
  gyroInvalidSamplesAtStop = 0;
  firstLeftTickMs = 0;
  firstRightTickMs = 0;
  consecutiveGyroFailures = 0;
  gyroDisabledForRun = false;
  gyroResidualBiasValid = false;
  yaw = 0.0f;
  lastGyroZ = 0.0f;
  previousGyroMicros = micros();
}

void resetYaw() {
  yaw = 0.0f;
  lastGyroZ = 0.0f;
  previousGyroMicros = micros();
}

void updateGyro() {
  // ถ้ากู้บัสหลายครั้งแล้วยังไม่กลับมา ให้หยุดเรียก MPU ในรอบนี้
  if (!gyroAvailable || gyroDisabledForRun) return;

  unsigned long now = micros();
  unsigned long elapsed = now - previousGyroMicros;

  // ~50 Hz
  if (elapsed < GYRO_UPDATE_INTERVAL_US) return;

  float dt = elapsed / 1000000.0f;
  previousGyroMicros = now;

  int16_t rawValue;
  if (!readGyroZRaw(rawValue)) {
    gyroReadFailures++;
    consecutiveGyroFailures++;
    if (consecutiveGyroFailures >= 5) {
      recoverMPU6050Bus();
      if (gyroBusRecoveries >= MAX_GYRO_RECOVERIES_PER_RUN) {
        gyroDisabledForRun = true;
      }
    }
    return; // ห้ามนำ raw = 0 ปลอมไปสะสมเป็น Yaw
  }

  consecutiveGyroFailures = 0;

  float gyroZ = ((float)rawValue / 131.0f) - gyroZOffset;
  gyroZ *= GYRO_SIGN;

  float maxValidRate = rotationGyroRateMode
                     ? MAX_VALID_ROTATION_GYRO_RATE
                     : MAX_VALID_GYRO_RATE;
  if (fabs(gyroZ) > maxValidRate) {
    gyroInvalidSamples++;
    return;
  }

  // ลด noise ตอนเกือบนิ่ง
  if (fabs(gyroZ) < 0.15f) gyroZ = 0.0f;

  lastGyroZ = gyroZ;
  yaw += gyroZ * dt;
}

float measureResidualGyroBias() {
  // เรียกใช้หลังรถหยุดสนิทเท่านั้น ค่าเฉลี่ยนี้ใช้แก้ drift ย้อนหลัง
  gyroResidualBiasValid = false;
  if (!gyroAvailable || gyroDisabledForRun) return 0.0f;

  const int samples = RESIDUAL_GYRO_SAMPLES;
  float total = 0.0f;
  int validSamples = 0;
  int attempts = 0;
  unsigned long measurementStartMs = millis();

  while (validSamples < samples
         && attempts < samples * 3
         && millis() - measurementStartMs
            < RESIDUAL_MEASUREMENT_TIMEOUT_MS) {
    int16_t rawValue;
    if (readGyroZRaw(rawValue)) {
      float gyroZ = ((float)rawValue / 131.0f) - gyroZOffset;
      gyroZ *= GYRO_SIGN;

      if (fabs(gyroZ) <= MAX_RESIDUAL_SAMPLE_RATE) {
        total += gyroZ;
        validSamples++;
      } else {
        // แยกจาก invalid ระหว่างวิ่ง เพราะไม่ควรทำลาย Yaw at stop
        gyroResidualRejectedSamples++;
      }
      consecutiveGyroFailures = 0;
    } else {
      gyroReadFailures++;
      consecutiveGyroFailures++;
      if (consecutiveGyroFailures >= 5) {
        recoverMPU6050Bus();
        if (gyroBusRecoveries >= MAX_GYRO_RECOVERIES_PER_RUN) {
          gyroDisabledForRun = true;
          break;
        }
      }
    }
    attempts++;
    delay(2);
  }

  // ต้องได้อย่างน้อย 80% จึงถือว่า bias หลังหยุดเชื่อถือได้
  if (validSamples < (samples * 8) / 10) return 0.0f;
  gyroResidualBiasValid = true;
  return total / validSamples;
}

// =====================================================
// MOTOR
// =====================================================
void motorForwardDirection() {
  digitalWrite(IN1, HIGH);
  digitalWrite(IN2, LOW);
  digitalWrite(IN3, HIGH);
  digitalWrite(IN4, LOW);
}

void motorRotateDirection(int direction) {
  if (direction >= 0) {
    // หมุนขวา: ล้อซ้ายเดินหน้า ล้อขวาถอยหลัง
    digitalWrite(IN1, HIGH);
    digitalWrite(IN2, LOW);
    digitalWrite(IN3, LOW);
    digitalWrite(IN4, HIGH);
  } else {
    // หมุนซ้าย: ล้อซ้ายถอยหลัง ล้อขวาเดินหน้า
    digitalWrite(IN1, LOW);
    digitalWrite(IN2, HIGH);
    digitalWrite(IN3, HIGH);
    digitalWrite(IN4, LOW);
  }
}

void Stop() {
  analogWrite(ENA, 0);
  analogWrite(ENB, 0);

  digitalWrite(IN1, LOW);
  digitalWrite(IN2, LOW);
  digitalWrite(IN3, LOW);
  digitalWrite(IN4, LOW);
}

// Single-channel encoders: no pulses is only an indication of rest.
// Require both a minimum observation interval and a quiet window, with a deadline.
bool waitForEncoderStop() {
  unsigned long start = millis(), lastChange = start;
  unsigned long oldL, oldR;
  readEncoders(oldL, oldR);
  while (millis() - start < 2000) {
    unsigned long left, right;
    readEncoders(left, right);
    unsigned long now = millis();
    if (left != oldL || right != oldR) { lastChange = now; oldL = left; oldR = right; }
    if (now - start >= 500 && now - lastChange >= 200) return true;
    delay(5);
  }
  return false;
}

// L298: เปิด EN เต็มและตั้งขั้วทั้งสองด้านเท่ากันเพื่อ short-brake มอเตอร์
// ใช้เฉพาะตอนจบการหมุน และยังอ่าน Gyro ระหว่างเบรกเพื่อไม่ให้ Yaw ขาดช่วง
void activeBrakeRotation(unsigned long durationMs) {
  digitalWrite(IN1, LOW);
  digitalWrite(IN2, LOW);
  digitalWrite(IN3, LOW);
  digitalWrite(IN4, LOW);
  analogWrite(ENA, PWM_MAX);
  analogWrite(ENB, PWM_MAX);

  unsigned long brakeStartMs = millis();
  while (millis() - brakeStartMs < durationMs) {
    updateGyro();
    delay(2);
  }
  Stop();
}

// =====================================================
// LEFT WHEEL ONLY TEST
// ใช้ตรวจว่า ENA และ ENC_L เป็นล้อซ้ายจริงหรือไม่
// รถจะโค้งไปทางขวา เพราะล้อขวาไม่หมุน
// =====================================================
void testLeftWheelOnly(float speed, unsigned long durationMs) {
  resetEncoders();
  resetYaw();
  motorForwardDirection();

  unsigned long startMs = millis();

  analogWrite(ENA, speedToPWM(speed)); // ล้อซ้าย
  analogWrite(ENB, 0);                 // ล้อขวาหยุด

  while (millis() - startMs < durationMs) {
    updateGyro();
    delay(2);
  }

  readEncoders(leftAtStopCommand, rightAtStopCommand);
  yawAtStopCommand = yaw;
  gyroReadFailuresAtStop = gyroReadFailures;
  gyroBusRecoveriesAtStop = gyroBusRecoveries;
  gyroInvalidSamplesAtStop = gyroInvalidSamples;
  Stop();
  runTimeMs = millis() - startMs;

  unsigned long settleStart = millis();
  while (millis() - settleStart < SETTLE_TIME_MS) {
    updateGyro();
    delay(2);
  }

  readEncoders(finalEncoderL, finalEncoderR);
  finalYaw = yaw;
  finalGyroZ = lastGyroZ;
  testFinished = true;
}

// =====================================================
// IN-PLACE ROTATION GYRO LEARNING
// ใช้ Gyro หยุดที่มุมเป้าหมาย แล้วบันทึก encoder สำหรับ replay ภายหลัง
// =====================================================
void rotateGyroLearning(float targetAngleDeg, int direction) {
  direction = direction >= 0 ? 1 : -1;
  int yawDirectionSign = RIGHT_TURN_GYRO_SIGN * direction;
  commandedRotationDeg = fabs(targetAngleDeg);
  commandedRotationDirection = direction;
  commandedSpeed = ROTATE_CRUISE_SPEED_CM_S;

  testFinished = false;
  runTimedOut = false;
  rotationAbortedGyro = false;
  rotationAbortedWrongDirection = false;
  rotationAbortedWheelStart = false;
  rotationAbortedWheelMismatch = false;
  rotationGyroRateMode = true;
  predictedYawAtStop = 0.0f;
  maxAbsRotationRate = 0.0f;
  gyroReadFailures = 0;
  gyroRetrySuccesses = 0;
  gyroBusRecoveries = 0;
  gyroInvalidSamples = 0;
  gyroResidualRejectedSamples = 0;
  gyroReadFailuresAtStop = 0;
  gyroBusRecoveriesAtStop = 0;
  gyroInvalidSamplesAtStop = 0;
  consecutiveGyroFailures = 0;
  gyroDisabledForRun = !gyroAvailable;
  gyroResidualBiasValid = false;
  firstLeftTickMs = 0;
  firstRightTickMs = 0;
  cruiseSpeedLeft = 0.0f;
  cruiseSpeedRight = 0.0f;

  resetEncoders();
  resetYaw();
  motorRotateDirection(direction);

  unsigned long startMs = millis();
  unsigned long lastSpeedUpdateMs = startMs;
  unsigned long previousLeftTicks = 0;
  unsigned long previousRightTicks = 0;
  float filteredSpeedLeft = 0.0f;
  float filteredSpeedRight = 0.0f;
  float integralLeft = 0.0f;
  float integralRight = 0.0f;
  int piTrimLeftPWM = 0;
  int piTrimRightPWM = 0;
  bool speedFilterReady = false;
  float cruiseLeftSum = 0.0f;
  float cruiseRightSum = 0.0f;
  unsigned int cruiseSamples = 0;
  unsigned long maxRotationRunMs =
    5000UL + (unsigned long)(commandedRotationDeg * 50.0f);

  while (true) {
    updateGyro();

    unsigned long leftTicks, rightTicks;
    readEncoders(leftTicks, rightTicks);

    if (firstLeftTickMs == 0 && leftTicks > 0) {
      firstLeftTickMs = millis() - startMs;
    }
    if (firstRightTickMs == 0 && rightTicks > 0) {
      firstRightTickMs = millis() - startMs;
    }

    unsigned long elapsedMs = millis() - startMs;
    if (elapsedMs >= ROTATE_WHEEL_START_TIMEOUT_MS
        && (leftTicks == 0 || rightTicks == 0)) {
      rotationAbortedWheelStart = true;
      break;
    }

    if (fabs(lastGyroZ) > maxAbsRotationRate) {
      maxAbsRotationRate = fabs(lastGyroZ);
    }

    bool gyroControlSafe = gyroAvailable
                        && !gyroDisabledForRun
                        && gyroReadFailures <= 20
                        && gyroBusRecoveries <= 2
                        && gyroInvalidSamples <= 5;
    if (!gyroControlSafe) {
      rotationAbortedGyro = true;
      break;
    }

    float progressDeg = yawDirectionSign * yaw;
    float towardTargetRate = yawDirectionSign * lastGyroZ;
    if (progressDeg < -MAX_WRONG_DIRECTION_DEG) {
      rotationAbortedWrongDirection = true;
      break;
    }

    float predictedProgressDeg = progressDeg;
    if (towardTargetRate > 0.0f) {
      predictedProgressDeg += towardTargetRate * ROTATE_STOP_LOOKAHEAD_SEC;
    }
    predictedYawAtStop = yawDirectionSign * predictedProgressDeg;

    if (predictedProgressDeg >= commandedRotationDeg) break;

    if (millis() - startMs >= maxRotationRunMs) {
      runTimedOut = true;
      break;
    }

    float remainingDeg = commandedRotationDeg - progressDeg;
    float approachRatio = constrain(remainingDeg / ROTATE_SLOW_ANGLE_DEG,
                                    0.0f,
                                    1.0f);
    float approachSpeed = ROTATE_MIN_SPEED_CM_S
                        + (ROTATE_CRUISE_SPEED_CM_S
                           - ROTATE_MIN_SPEED_CM_S) * approachRatio;
    float rampRatio = constrain(elapsedMs / (float)ROTATE_SOFT_START_MS,
                                0.0f,
                                1.0f);
    float rampSpeed = ROTATE_MIN_SPEED_CM_S
                    + (ROTATE_CRUISE_SPEED_CM_S
                       - ROTATE_MIN_SPEED_CM_S) * rampRatio;
    float targetWheelSpeed = min(approachSpeed, rampSpeed);

    float encoderDiff = (long)rightTicks - (long)leftTicks;
    float syncSpeed = constrain(KP_ROTATE_SYNC_SPEED * encoderDiff,
                                -MAX_ROTATE_SYNC_SPEED_CM_S,
                                MAX_ROTATE_SYNC_SPEED_CM_S);
    float referenceLeft = constrain(targetWheelSpeed + syncSpeed,
                                    0.0f,
                                    ROTATE_CRUISE_SPEED_CM_S);
    float referenceRight = constrain(targetWheelSpeed - syncSpeed,
                                     0.0f,
                                     ROTATE_CRUISE_SPEED_CM_S);

    unsigned long nowMs = millis();
    unsigned long speedElapsedMs = nowMs - lastSpeedUpdateMs;
    if (speedElapsedMs >= SPEED_CONTROL_INTERVAL_MS) {
      float dt = speedElapsedMs / 1000.0f;
      float measuredLeft =
        ((leftTicks - previousLeftTicks) * CM_PER_TICK) / dt;
      float measuredRight =
        ((rightTicks - previousRightTicks) * CM_PER_TICK) / dt;

      if (!speedFilterReady) {
        filteredSpeedLeft = measuredLeft;
        filteredSpeedRight = measuredRight;
        speedFilterReady = true;
      } else {
        filteredSpeedLeft = 0.6f * measuredLeft
                          + 0.4f * filteredSpeedLeft;
        filteredSpeedRight = 0.6f * measuredRight
                           + 0.4f * filteredSpeedRight;
      }

      float errorLeft = referenceLeft - filteredSpeedLeft;
      float errorRight = referenceRight - filteredSpeedRight;
      integralLeft = constrain(integralLeft + errorLeft * dt,
                               -MAX_SPEED_INTEGRAL,
                               MAX_SPEED_INTEGRAL);
      integralRight = constrain(integralRight + errorRight * dt,
                                -MAX_SPEED_INTEGRAL,
                                MAX_SPEED_INTEGRAL);
      piTrimLeftPWM = (int)(KP_SPEED * errorLeft)
                    + (int)(KI_SPEED * integralLeft);
      piTrimRightPWM = (int)(KP_SPEED * errorRight)
                     + (int)(KI_SPEED * integralRight);
      piTrimLeftPWM = constrain(piTrimLeftPWM, -PWM_MAX, PWM_MAX);
      piTrimRightPWM = constrain(piTrimRightPWM, -PWM_MAX, PWM_MAX);

      if (approachRatio >= 1.0f && rampRatio >= 1.0f) {
        cruiseLeftSum += measuredLeft;
        cruiseRightSum += measuredRight;
        cruiseSamples++;
      }

      previousLeftTicks = leftTicks;
      previousRightTicks = rightTicks;
      lastSpeedUpdateMs = nowMs;
    }

    int pwmLeft = constrain(speedToPWM(referenceLeft) + piTrimLeftPWM,
                            0,
                            PWM_MAX);
    int pwmRight = constrain(speedToPWM(referenceRight) + piTrimRightPWM,
                             0,
                             PWM_MAX);
    pwmLeft = max(pwmLeft, ROTATE_RUNNING_PWM_FLOOR);
    pwmRight = max(pwmRight, ROTATE_RUNNING_PWM_FLOOR);
    if (leftTicks == 0 && elapsedMs < ROTATE_START_KICK_MS) {
      pwmLeft = max(pwmLeft, ROTATE_START_KICK_PWM);
    }
    if (rightTicks == 0 && elapsedMs < ROTATE_START_KICK_MS) {
      pwmRight = max(pwmRight, ROTATE_START_KICK_PWM);
    }
    analogWrite(ENA, pwmLeft);
    analogWrite(ENB, pwmRight);
  }

  runTimeMs = millis() - startMs;
  readEncoders(leftAtStopCommand, rightAtStopCommand);
  yawAtStopCommand = yaw;
  gyroIntegrationTimeMs = runTimeMs;
  gyroReadFailuresAtStop = gyroReadFailures;
  gyroBusRecoveriesAtStop = gyroBusRecoveries;
  gyroInvalidSamplesAtStop = gyroInvalidSamples;
  if (cruiseSamples > 0) {
    cruiseSpeedLeft = cruiseLeftSum / cruiseSamples;
    cruiseSpeedRight = cruiseRightSum / cruiseSamples;
  }

  Stop();
  Serial.println("ROTATION STOPPED - DO NOT TOUCH ROBOT");

  unsigned long settleStart = millis();
  while (millis() - settleStart < SETTLE_TIME_MS) {
    updateGyro();
    delay(2);
  }

  readEncoders(finalEncoderL, finalEncoderR);
  finalYaw = yaw;
  rotationGyroRateMode = false;
  finalGyroZ = measureResidualGyroBias();
  Serial.println("ROTATION MEASUREMENT COMPLETE");
  testFinished = true;
}

// =====================================================
// DIRECT 360-DEG GYRO MEASUREMENT
// Gyro เป็นตัวตัดมุม; encoder ใช้รักษาจำนวนซ้าย/ขวาใกล้กันและบันทึกผล
// =====================================================
void rotateGyroMeasureEncoder(float targetAngleDeg, int direction) {
  direction = direction >= 0 ? 1 : -1;
  int yawDirectionSign = RIGHT_TURN_GYRO_SIGN * direction;
  commandedRotationDeg = fabs(targetAngleDeg);
  commandedRotationDirection = direction;
  commandedSpeed = 0.0f;
  rotationEncoderReplayMode = false;

  testFinished = false;
  runTimedOut = false;
  rotationAbortedGyro = false;
  rotationAbortedWrongDirection = false;
  rotationAbortedWheelStart = false;
  rotationAbortedWheelMismatch = false;
  rotationGyroRateMode = true;
  predictedYawAtStop = 0.0f;
  maxAbsRotationRate = 0.0f;
  gyroReadFailures = 0;
  gyroRetrySuccesses = 0;
  gyroBusRecoveries = 0;
  gyroInvalidSamples = 0;
  gyroResidualRejectedSamples = 0;
  gyroReadFailuresAtStop = 0;
  gyroBusRecoveriesAtStop = 0;
  gyroInvalidSamplesAtStop = 0;
  consecutiveGyroFailures = 0;
  gyroDisabledForRun = !gyroAvailable;
  gyroResidualBiasValid = false;
  firstLeftTickMs = 0;
  firstRightTickMs = 0;
  cruiseSpeedLeft = 0.0f;
  cruiseSpeedRight = 0.0f;

  resetEncoders();
  resetYaw();
  motorRotateDirection(direction);

  unsigned long startMs = millis();
  unsigned long maxRotationRunMs =
    8000UL + (unsigned long)(commandedRotationDeg * 50.0f);

  while (true) {
    updateGyro();

    unsigned long leftTicks, rightTicks;
    readEncoders(leftTicks, rightTicks);
    unsigned long elapsedMs = millis() - startMs;

    if (firstLeftTickMs == 0 && leftTicks > 0) {
      firstLeftTickMs = elapsedMs;
    }
    if (firstRightTickMs == 0 && rightTicks > 0) {
      firstRightTickMs = elapsedMs;
    }
    if (fabs(lastGyroZ) > maxAbsRotationRate) {
      maxAbsRotationRate = fabs(lastGyroZ);
    }

    bool gyroControlSafe = gyroAvailable
                        && !gyroDisabledForRun
                        && gyroReadFailures <= 20
                        && gyroBusRecoveries <= 2
                        && gyroInvalidSamples <= 5;
    if (!gyroControlSafe) {
      rotationAbortedGyro = true;
      break;
    }

    if (elapsedMs >= ROTATE_WHEEL_START_TIMEOUT_MS
        && (leftTicks == 0 || rightTicks == 0)) {
      rotationAbortedWheelStart = true;
      break;
    }

    float progressDeg = yawDirectionSign * yaw;
    if (progressDeg < -MAX_WRONG_DIRECTION_DEG) {
      rotationAbortedWrongDirection = true;
      break;
    }
    predictedYawAtStop = yaw;

    // รอบนี้ตั้งใจรอให้ Gyro วัดถึงมุมจริงก่อนจึงตัดกำลัง
    if (progressDeg >= commandedRotationDeg) break;
    if (elapsedMs >= maxRotationRunMs) {
      runTimedOut = true;
      break;
    }

    float remainingDeg = commandedRotationDeg - progressDeg;
    int basePWM = elapsedMs < ROTATE_DIRECT_START_MS
                ? ROTATE_DIRECT_START_PWM
                : ROTATE_DIRECT_CRUISE_PWM;
    if (remainingDeg < ROTATE_DIRECT_SLOW_ANGLE_DEG) {
      float slowRatio = constrain(
        remainingDeg / ROTATE_DIRECT_SLOW_ANGLE_DEG,
        0.0f,
        1.0f
      );
      basePWM = ROTATE_DIRECT_SLOW_PWM
              + (int)((ROTATE_DIRECT_CRUISE_PWM
                       - ROTATE_DIRECT_SLOW_PWM) * slowRatio);
    }

    long countError = (long)rightTicks - (long)leftTicks;
    int countCorrection = constrain(
      (int)(KP_ROTATE_COUNT_PWM * countError),
      -MAX_ROTATE_COUNT_PWM_CORRECTION,
      MAX_ROTATE_COUNT_PWM_CORRECTION
    );
    // เพิ่มเฉพาะล้อที่ตามหลัง ห้ามลดอีกล้อต่ำกว่า basePWM เพราะจากผลจริง
    // PWM ต่ำกว่า 2000 ทำให้มอเตอร์มีเสียงแต่แรงไม่พอหมุน
    int pwmLeft = basePWM;
    int pwmRight = basePWM;
    if (countCorrection > 0) {
      pwmLeft = constrain(basePWM + countCorrection, 0, PWM_MAX);
    } else if (countCorrection < 0) {
      pwmRight = constrain(basePWM - countCorrection, 0, PWM_MAX);
    }
    analogWrite(ENA, pwmLeft);
    analogWrite(ENB, pwmRight);
  }

  runTimeMs = millis() - startMs;
  readEncoders(leftAtStopCommand, rightAtStopCommand);
  yawAtStopCommand = yaw;
  gyroIntegrationTimeMs = runTimeMs;
  gyroReadFailuresAtStop = gyroReadFailures;
  gyroBusRecoveriesAtStop = gyroBusRecoveries;
  gyroInvalidSamplesAtStop = gyroInvalidSamples;
  if (runTimeMs > 0) {
    float runTimeSec = runTimeMs / 1000.0f;
    cruiseSpeedLeft = leftAtStopCommand * CM_PER_TICK / runTimeSec;
    cruiseSpeedRight = rightAtStopCommand * CM_PER_TICK / runTimeSec;
  }

  Stop();
  Serial.println("360 ROTATION STOPPED - DO NOT TOUCH ROBOT");

  unsigned long settleStart = millis();
  while (millis() - settleStart < SETTLE_TIME_MS) {
    updateGyro();
    delay(2);
  }

  readEncoders(finalEncoderL, finalEncoderR);
  finalYaw = yaw;
  rotationGyroRateMode = false;
  finalGyroZ = measureResidualGyroBias();
  Serial.println("360 ROTATION MEASUREMENT COMPLETE");
  testFinished = true;
}

// =====================================================
// ENCODER-ONLY ROTATION REPLAY
// Encoder เป็นตัวสั่งหยุด; Gyro ใช้บันทึกผลเท่านั้นและถอดออกได้ตอนสอบ
// =====================================================
void rotateEncoderReplay(float targetAngleDeg, int direction) {
  direction = direction >= 0 ? 1 : -1;
  commandedRotationDeg = fabs(targetAngleDeg);
  commandedRotationDirection = direction;
  commandedSpeed = ROTATE_REPLAY_SPEED_CM_S;
  rotationEncoderReplayMode = true;

  float learnedLeftTicks360 = direction > 0
                            ? ROTATE_RIGHT_LEFT_TICKS_360
                            : ROTATE_LEFT_LEFT_TICKS_360;
  float learnedRightTicks360 = direction > 0
                             ? ROTATE_RIGHT_RIGHT_TICKS_360
                             : ROTATE_LEFT_RIGHT_TICKS_360;
  float angleScale = commandedRotationDeg / 360.0f;
  rotationTargetLeftTicks = max(
    1UL,
    (unsigned long)lroundf(learnedLeftTicks360 * angleScale)
  );
  rotationTargetRightTicks = max(
    1UL,
    (unsigned long)lroundf(learnedRightTicks360 * angleScale)
  );

  testFinished = false;
  runTimedOut = false;
  rotationAbortedGyro = false;
  rotationAbortedWrongDirection = false;
  rotationAbortedWheelStart = false;
  rotationAbortedWheelMismatch = false;
  rotationGyroRateMode = true;
  predictedYawAtStop = 0.0f;
  maxAbsRotationRate = 0.0f;
  gyroReadFailures = 0;
  gyroRetrySuccesses = 0;
  gyroBusRecoveries = 0;
  gyroInvalidSamples = 0;
  gyroResidualRejectedSamples = 0;
  gyroReadFailuresAtStop = 0;
  gyroBusRecoveriesAtStop = 0;
  gyroInvalidSamplesAtStop = 0;
  consecutiveGyroFailures = 0;
  gyroDisabledForRun = !gyroAvailable;
  gyroResidualBiasValid = false;
  firstLeftTickMs = 0;
  firstRightTickMs = 0;
  cruiseSpeedLeft = 0.0f;
  cruiseSpeedRight = 0.0f;

  resetEncoders();
  resetYaw();
  motorRotateDirection(direction);

  unsigned long startMs = millis(), previousControlMs = startMs;
  unsigned long previousL = 0, previousR = 0;
  unsigned long oneDoneSince = 0;
  unsigned long lastL = startMs, lastR = startMs;
  EncoderMotion::Profile profile;
  EncoderMotion::Wheel wheelL(startMs), wheelR(startMs);
  unsigned long maxRotationRunMs = 5000UL + (unsigned long)(commandedRotationDeg * 80.0f);
  while (true) {
    updateGyro();
    unsigned long leftTicks, rightTicks;
    readEncoders(leftTicks, rightTicks);
    unsigned long now = millis();
    if (leftTicks != previousL) { lastL = now; previousL = leftTicks; }
    if (rightTicks != previousR) { lastR = now; previousR = rightTicks; }
    if (!firstLeftTickMs && leftTicks) firstLeftTickMs = now - startMs;
    if (!firstRightTickMs && rightTicks) firstRightTickMs = now - startMs;
    bool doneL = leftTicks >= rotationTargetLeftTicks;
    bool doneR = rightTicks >= rotationTargetRightTicks;
    if (doneL && doneR) break;
    if (doneL != doneR) {
      if (!oneDoneSince) oneDoneSince = now;
      if (now - oneDoneSince >= ROTATE_ONE_WHEEL_TIMEOUT_MS) {
        rotationAbortedWheelMismatch = true;
        break;
      }
    } else oneDoneSince = 0;
    if ((!doneL && now - lastL >= 2000) || (!doneR && now - lastR >= 2000)) {
      rotationAbortedWheelStart = true;
      break;
    }
    if (now - startMs >= maxRotationRunMs) { runTimedOut = true; break; }
    float dt = (now - previousControlMs) * 0.001f;
    previousControlMs = now;
    EncoderMotion::References refs = profile.step(
      leftTicks, rightTicks, rotationTargetLeftTicks, rotationTargetRightTicks,
      CM_PER_TICK, ROTATE_REPLAY_SPEED_CM_S, 10.0f, 30.0f, 40.0f, dt);
    int pwmL = wheelL.update(now, leftTicks, refs.left, CM_PER_TICK, PWM_MAX,
                             2400.0f / 4095.0f, 600.0f / 4095.0f);
    int pwmR = wheelR.update(now, rightTicks, refs.right, CM_PER_TICK, PWM_MAX,
                             2400.0f / 4095.0f, 600.0f / 4095.0f);
    // Bounded startup assist; never repeatedly kick a stalled wheel.
    if (now - startMs < 200) {
      if (!leftTicks && refs.left > 0) pwmL = ROTATE_DIRECT_START_PWM;
      if (!rightTicks && refs.right > 0) pwmR = ROTATE_DIRECT_START_PWM;
    }
    analogWrite(ENA, doneL ? 0 : pwmL);
    analogWrite(ENB, doneR ? 0 : pwmR);
    delay(5);
  }

  runTimeMs = millis() - startMs;
  readEncoders(leftAtStopCommand, rightAtStopCommand);
  yawAtStopCommand = yaw;
  predictedYawAtStop = yaw;
  gyroIntegrationTimeMs = runTimeMs;
  gyroReadFailuresAtStop = gyroReadFailures;
  gyroBusRecoveriesAtStop = gyroBusRecoveries;
  gyroInvalidSamplesAtStop = gyroInvalidSamples;
  if (runTimeMs > 0) {
    float runTimeSec = runTimeMs / 1000.0f;
    cruiseSpeedLeft = leftAtStopCommand * CM_PER_TICK / runTimeSec;
    cruiseSpeedRight = rightAtStopCommand * CM_PER_TICK / runTimeSec;
  }

  activeBrakeRotation(ROTATE_ACTIVE_BRAKE_MS);
  motionSettled = waitForEncoderStop();
  Serial.println("ENCODER ROTATION STOPPED - DO NOT TOUCH ROBOT");

  unsigned long settleStart = millis();
  while (millis() - settleStart < SETTLE_TIME_MS) {
    updateGyro();
    delay(2);
  }

  readEncoders(finalEncoderL, finalEncoderR);
  finalYaw = yaw;
  rotationGyroRateMode = false;
  finalGyroZ = measureResidualGyroBias();
  Serial.print("STOP_COUNTS L/R: "); Serial.print(leftAtStopCommand);
  Serial.print('/'); Serial.println(rightAtStopCommand);
  Serial.print("FINAL_COUNTS L/R: "); Serial.print(finalEncoderL);
  Serial.print('/'); Serial.println(finalEncoderR);
  Serial.print("ENCODER_SETTLED: "); Serial.println(motionSettled ? "YES" : "NO");
  Serial.println("ENCODER ROTATION REPLAY FINISHED");
  testFinished = true;
}

// =====================================================
// STAGED GYRO-LEARNING / ENCODER-ONLY REPLAY RUN
// speedCMPerSec คือความเร็วเป้าหมายจริง ไม่ใช่เปอร์เซ็นต์ PWM
// โหมดกำหนดด้วย USE_GYRO_ASSIST
// =====================================================
void forwardClosedLoop(float speedCMPerSec, float distanceCM) {
  activeSegmentCount = (int)ceilf(distanceCM / CALIBRATION_SEGMENT_CM);
  activeSegmentCount = constrain(activeSegmentCount,
                                 1,
                                 MAX_CALIBRATION_SEGMENTS);
  commandedDistanceCM = distanceCM;
  testFinished = false;

  resetEncoders();
  resetYaw();
  motorForwardDirection();

  const unsigned long targetTicks = cmToTicks(distanceCM);
  const unsigned long slowZoneTicks = cmToTicks(SLOW_ZONE_CM);
  const unsigned long warmupTicks = cmToTicks(15.0f);

  commandedSpeed = speedCMPerSec;
  runTimedOut = false;
  straightStalled = false;
  gyroReadFailures = 0;
  gyroRetrySuccesses = 0;
  gyroBusRecoveries = 0;
  gyroInvalidSamples = 0;
  gyroResidualRejectedSamples = 0;
  gyroReadFailuresAtStop = 0;
  gyroBusRecoveriesAtStop = 0;
  gyroInvalidSamplesAtStop = 0;
  consecutiveGyroFailures = 0;
  gyroDisabledForRun = !gyroAvailable;
  gyroResidualBiasValid = false;
  learningAbortedGyro = false;
  learningAbortedYawLimit = false;
  capturedSegmentCount = 0;
  firstLeftTickMs = 0;
  firstRightTickMs = 0;
  cruiseSpeedLeft = 0.0f;
  cruiseSpeedRight = 0.0f;

  for (int i = 0; i < MAX_CALIBRATION_SEGMENTS; i++) {
    segmentYaw[i] = 0.0f;
    segmentGyroRateAtCheckpoint[i] = 0.0f;
    segmentMaxAbsYaw[i] = 0.0f;
    segmentTimeSec[i] = 0.0f;
    segmentEncoderL[i] = 0;
    segmentEncoderR[i] = 0;
    checkpointEncoderL[i] = 0;
    checkpointEncoderR[i] = 0;
    segmentGyroCorrectionSum[i] = 0.0f;
    segmentGyroSpeedCorrectionSum[i] = 0.0f;
    segmentLearningBalancePWMSum[i] = 0.0f;
    segmentGyroCorrectionSamples[i] = 0;
  }

  int nextSegmentToCapture = 0;
  unsigned long accumulatedPauseMs = 0;
  float stageStartAverageTicks = 0.0f;
  float nextCheckpointAverageTicks =
    checkpointTicksForIndex(0, distanceCM);
  unsigned long stageStartLeftTicks = 0;
  unsigned long stageStartRightTicks = 0;

  unsigned long startMs = millis();
  unsigned long stageMotionStartMs = startMs;
  unsigned long lastMovingL = startMs, lastMovingR = startMs;
  unsigned long observedL = 0, observedR = 0;
  unsigned long lastSpeedUpdateMs = startMs;
  unsigned long previousSpeedLeftTicks = 0;
  unsigned long previousSpeedRightTicks = 0;

  float filteredSpeedLeft = 0.0f;
  float filteredSpeedRight = 0.0f;
  float speedIntegralLeft = 0.0f;
  float speedIntegralRight = 0.0f;
  float commonSpeedIntegral = 0.0f;
  bool speedFilterReady = false;
  // Feed-forward คำนวณทุก loop; PI trim อัปเดตจาก encoder ทุก 200 ms
  int piTrimLeftPWM = 0;
  int piTrimRightPWM = 0;
  float cruiseSpeedLeftSum = 0.0f;
  float cruiseSpeedRightSum = 0.0f;
  unsigned int cruiseSamples = 0;

  while (true) {
    updateGyro();

    unsigned long leftTicks, rightTicks;
    readEncoders(leftTicks, rightTicks);

    if (firstLeftTickMs == 0 && leftTicks > 0) {
      firstLeftTickMs = millis() - startMs;
    }
    if (firstRightTickMs == 0 && rightTicks > 0) {
      firstRightTickMs = millis() - startMs;
    }

    // ใช้ระยะเฉลี่ยของสองล้อเป็นระยะของตัวรถ
    float averageTicks = (leftTicks + rightTicks) * 0.5f;
    unsigned long movementNow = millis();
    if (leftTicks != observedL) { observedL = leftTicks; lastMovingL = movementNow; }
    if (rightTicks != observedR) { observedR = rightTicks; lastMovingR = movementNow; }
    if ((leftTicks < targetTicks && movementNow - lastMovingL >= 2000)
        || (rightTicks < targetTicks && movementNow - lastMovingR >= 2000)) {
      straightStalled = true;
      leftAtStopCommand = leftTicks; rightAtStopCommand = rightTicks;
      Serial.println("STRAIGHT STALL - NO ENCODER PROGRESS");
      break;
    }


    bool gyroControlSafe = gyroAvailable
                        && !gyroDisabledForRun
                        && gyroReadFailures <= 20
                        && gyroBusRecoveries <= 2
                        && gyroInvalidSamples <= 5;

    // รอบเรียนรู้ต้องใช้ Gyro ตลอดทาง ถ้าข้อมูลเสียให้หยุดทันที
    // ห้ามกลับไปบังคับ R-L = 0 เพราะจะลบค่าที่เพิ่งเรียนและทำให้รถหัก
    if (USE_GYRO_ASSIST && !gyroControlSafe) {
      learningAbortedGyro = true;
      yawAtStopCommand = yaw;
      leftAtStopCommand = leftTicks;
      rightAtStopCommand = rightTicks;
      gyroIntegrationTimeMs = millis() - startMs;
      gyroReadFailuresAtStop = gyroReadFailures;
      gyroBusRecoveriesAtStop = gyroBusRecoveries;
      gyroInvalidSamplesAtStop = gyroInvalidSamples;
      break;
    }

    // ป้องกันรถเลี้ยวแรงหากทิศ Gyro หรือการต่อมอเตอร์ผิดจากที่ตรวจไว้
    if (USE_GYRO_ASSIST && fabs(yaw) >= MAX_LEARNING_YAW_DEG) {
      learningAbortedYawLimit = true;
      yawAtStopCommand = yaw;
      leftAtStopCommand = leftTicks;
      rightAtStopCommand = rightTicks;
      gyroIntegrationTimeMs = millis() - startMs;
      gyroReadFailuresAtStop = gyroReadFailures;
      gyroBusRecoveriesAtStop = gyroBusRecoveries;
      gyroInvalidSamplesAtStop = gyroInvalidSamples;
      break;
    }

    float gyroSpeedCorrection = 0.0f;
    if (USE_GYRO_ASSIST) {
      float yawForP = fabs(yaw) > GYRO_HEADING_DEADBAND_DEG
                    ? yaw
                    : 0.0f;
      gyroSpeedCorrection = constrain(
        KP_GYRO_HEADING_SPEED * yawForP
          + KD_GYRO_RATE_SPEED * lastGyroZ,
        -MAX_GYRO_SPEED_CORRECTION,
        MAX_GYRO_SPEED_CORRECTION
      );
    }

    int trackingSegment = min(nextSegmentToCapture,
                              activeSegmentCount - 1);
    if (fabs(yaw) > segmentMaxAbsYaw[trackingSegment]) {
      segmentMaxAbsYaw[trackingSegment] = fabs(yaw);
    }

    if (millis() - startMs >= MAX_RUN_TIME_MS) {
      runTimedOut = true;
      yawAtStopCommand = yaw;
      leftAtStopCommand = leftTicks;
      rightAtStopCommand = rightTicks;
      gyroIntegrationTimeMs = millis() - startMs;
      gyroReadFailuresAtStop = gyroReadFailures;
      gyroBusRecoveriesAtStop = gyroBusRecoveries;
      gyroInvalidSamplesAtStop = gyroInvalidSamples;
      break;
    }

    // จับค่าตอนข้ามเส้น 100, 200, ... cm เพียงครั้งเดียวต่อเส้น
    // เก็บทั้งมุม เวลา และ encoder เพื่อให้เทียบแต่ละช่วงย้อนหลังได้
    while (nextSegmentToCapture < activeSegmentCount) {
      bool finalCheckpoint =
        nextSegmentToCapture == activeSegmentCount - 1;
      if (finalCheckpoint) {
        if (activeForwardProfile == LONG_RANGE_PROFILE) {
          // longrangegood ให้ล้อทั้งสองข้างถึงระยะเป้าหมายก่อนจบสเตจ
          if (leftTicks < targetTicks || rightTicks < targetTicks) break;
        } else {
          // shortpathgood รักษาค่า R-L ที่เรียนไว้และหยุดที่ระยะกึ่งกลาง
          if (averageTicks < targetTicks) break;
        }
      } else if (averageTicks < nextCheckpointAverageTicks) {
        break;
      }

      segmentYaw[nextSegmentToCapture] = yaw;
      segmentGyroRateAtCheckpoint[nextSegmentToCapture] = lastGyroZ;
      segmentTimeSec[nextSegmentToCapture] =
        (millis() - startMs) / 1000.0f;
      // เก็บ tick เฉพาะ 100 cm ช่วงนี้ ไม่รวมช่วงก่อนหน้าและช่วงหยุด
      segmentEncoderL[nextSegmentToCapture] =
        leftTicks - stageStartLeftTicks;
      segmentEncoderR[nextSegmentToCapture] =
        rightTicks - stageStartRightTicks;
      checkpointEncoderL[nextSegmentToCapture] = leftTicks;
      checkpointEncoderR[nextSegmentToCapture] = rightTicks;
      nextSegmentToCapture++;
      capturedSegmentCount = nextSegmentToCapture;

      // สามารถเลือกหยุด 3 วินาทีระหว่างช่วง หรือวิ่งต่อเนื่องได้
      if (PAUSE_AT_CHECKPOINTS
          && nextSegmentToCapture < activeSegmentCount) {
        Stop();

        Serial.print("Checkpoint ");
        Serial.print(nextSegmentToCapture * CALIBRATION_SEGMENT_CM, 0);
        Serial.print(" cm | Yaw: ");
        Serial.print(yaw, 3);
        Serial.print(" deg | R-L: ");
        Serial.println((long)checkpointEncoderR[nextSegmentToCapture - 1]
                     - (long)checkpointEncoderL[nextSegmentToCapture - 1]);

        unsigned long pauseStart = millis();
        while (millis() - pauseStart < SEGMENT_PAUSE_MS) {
          updateGyro();
          delay(2);
        }
        accumulatedPauseMs += millis() - pauseStart;

        // เริ่มตัวควบคุมความเร็วใหม่ ไม่ให้ช่วงหยุดถูกคิดเป็นความเร็วศูนย์
        readEncoders(previousSpeedLeftTicks, previousSpeedRightTicks);
        stageStartAverageTicks = (previousSpeedLeftTicks
                                + previousSpeedRightTicks) * 0.5f;
        stageStartLeftTicks = previousSpeedLeftTicks;
        stageStartRightTicks = previousSpeedRightTicks;
        nextCheckpointAverageTicks = checkpointTicksForIndex(
          nextSegmentToCapture,
          distanceCM
        );
        lastSpeedUpdateMs = millis();
        stageMotionStartMs = lastSpeedUpdateMs;
        lastMovingL = lastMovingR = lastSpeedUpdateMs;
        filteredSpeedLeft = 0.0f;
        filteredSpeedRight = 0.0f;
        speedIntegralLeft = 0.0f;
        speedIntegralRight = 0.0f;
        commonSpeedIntegral = 0.0f;
        speedFilterReady = false;
        piTrimLeftPWM = 0;
        piTrimRightPWM = 0;
        motorForwardDirection();
      } else if (nextSegmentToCapture < activeSegmentCount) {
        // โหมดวิ่งต่อเนื่อง: เริ่มนับ 100 cm ช่วงใหม่ทันทีโดยไม่หยุด
        stageStartAverageTicks = averageTicks;
        stageStartLeftTicks = leftTicks;
        stageStartRightTicks = rightTicks;
        nextCheckpointAverageTicks = checkpointTicksForIndex(
          nextSegmentToCapture,
          distanceCM
        );
      }
    }

    if (nextSegmentToCapture >= activeSegmentCount) {
      yawAtStopCommand = yaw;
      leftAtStopCommand = leftTicks;
      rightAtStopCommand = rightTicks;
      gyroIntegrationTimeMs = millis() - startMs;
      gyroReadFailuresAtStop = gyroReadFailures;
      gyroBusRecoveriesAtStop = gyroBusRecoveries;
      gyroInvalidSamplesAtStop = gyroInvalidSamples;
      break;
    }

    // สร้างความเร็วเป้าหมายแบบลดลงเมื่อใกล้ถึงระยะสุดท้าย
    float remainingTicks = nextCheckpointAverageTicks - averageTicks;
    float targetSpeedNow = speedCMPerSec;

    // ค่อย ๆ เพิ่มความเร็วหลังออกตัวแต่ละช่วง ลดกระแสกระชากและไฟตก
    unsigned long stageMotionElapsedMs = millis() - stageMotionStartMs;
    if (stageMotionElapsedMs < MOTOR_SOFT_START_MS) {
      float ramp = stageMotionElapsedMs / (float)MOTOR_SOFT_START_MS;
      float rampSpeed = MIN_SLOW_SPEED_CM_S
                      + (speedCMPerSec - MIN_SLOW_SPEED_CM_S) * ramp;
      targetSpeedNow = min(targetSpeedNow, rampSpeed);
    }

    bool approachingRealStop = PAUSE_AT_CHECKPOINTS
                            || nextSegmentToCapture
                               == activeSegmentCount - 1;
    if (approachingRealStop && remainingTicks < slowZoneTicks) {
      float ratio = remainingTicks / slowZoneTicks;
      float minimumSpeed = min(10.0f, speedCMPerSec);
      float slowSpeed = max(minimumSpeed, sqrtf(2.0f * 40.0f * max(0.0f, remainingTicks * CM_PER_TICK)));
      targetSpeedNow = min(targetSpeedNow, slowSpeed);
    }

    float syncSpeed = 0.0f;
    if (!USE_GYRO_ASSIST) {
      float desiredEncoderDiff = desiredRightExtraTicks(
        averageTicks * CM_PER_TICK
      );
      float encoderPositionError =
        ((long)rightTicks - (long)leftTicks) - desiredEncoderDiff;
      syncSpeed = constrain(KP_SYNC_SPEED * encoderPositionError,
                            -MAX_SYNC_SPEED_CM_S,
                            MAX_SYNC_SPEED_CM_S);
    }

    // คำนวณทุก loop เพื่อให้ Gyro 50 Hz ส่งคำสั่งถึงมอเตอร์ทันที
    float speedReferenceLeft = targetSpeedNow + syncSpeed
                             - gyroSpeedCorrection;
    float speedReferenceRight = targetSpeedNow - syncSpeed
                              + gyroSpeedCorrection;
    speedReferenceLeft = constrain(speedReferenceLeft, 0.0f, 70.0f);
    speedReferenceRight = constrain(speedReferenceRight, 0.0f, 70.0f);

    // -----------------------------
    // Encoder speed PI control
    // วัดทุก 200 ms; dual-edge ให้ประมาณ 40 counts/rev
    // -----------------------------
    unsigned long nowMs = millis();
    unsigned long speedElapsedMs = nowMs - lastSpeedUpdateMs;

    if (speedElapsedMs >= SPEED_CONTROL_INTERVAL_MS) {
      float dt = speedElapsedMs / 1000.0f;
      unsigned long deltaLeft = leftTicks - previousSpeedLeftTicks;
      unsigned long deltaRight = rightTicks - previousSpeedRightTicks;

      float measuredSpeedLeft = (deltaLeft * CM_PER_TICK) / dt;
      float measuredSpeedRight = (deltaRight * CM_PER_TICK) / dt;

      // เก็บเฉพาะช่วงกลาง ไม่รวมการออกตัวและช่วงชะลอ
      float stageProgressTicks = averageTicks - stageStartAverageTicks;
      if (stageProgressTicks >= warmupTicks && remainingTicks >= slowZoneTicks) {
        cruiseSpeedLeftSum += measuredSpeedLeft;
        cruiseSpeedRightSum += measuredSpeedRight;
        cruiseSamples++;
      }

      if (!speedFilterReady) {
        filteredSpeedLeft = measuredSpeedLeft;
        filteredSpeedRight = measuredSpeedRight;
        speedFilterReady = true;
      } else {
        // Low-pass filter ลดการกระโดดครั้งละหนึ่ง encoder tick
        filteredSpeedLeft = 0.6f * measuredSpeedLeft
                          + 0.4f * filteredSpeedLeft;
        filteredSpeedRight = 0.6f * measuredSpeedRight
                           + 0.4f * filteredSpeedRight;
      }

      float speedErrorLeft = speedReferenceLeft - filteredSpeedLeft;
      float speedErrorRight = speedReferenceRight - filteredSpeedRight;

      if (USE_GYRO_ASSIST) {
        // Integral ร่วมคุมเฉพาะความเร็วเฉลี่ย จึงไม่ทิ้งแรงต่างซ้าย-ขวาค้าง
        float averageSpeedError = targetSpeedNow
          - (filteredSpeedLeft + filteredSpeedRight) * 0.5f;
        commonSpeedIntegral += averageSpeedError * dt;
        commonSpeedIntegral = constrain(commonSpeedIntegral,
                                        -MAX_COMMON_SPEED_INTEGRAL,
                                        MAX_COMMON_SPEED_INTEGRAL);
        int commonIntegralPWM =
          (int)(KI_COMMON_LEARNING_SPEED * commonSpeedIntegral);
        piTrimLeftPWM = (int)(KP_LEARNING_SPEED * speedErrorLeft)
                      + commonIntegralPWM;
        piTrimRightPWM = (int)(KP_LEARNING_SPEED * speedErrorRight)
                       + commonIntegralPWM;
      } else {
        speedIntegralLeft = EncoderMotion::integrate(
          speedIntegralLeft, speedErrorLeft, dt, KI_SPEED,
          speedToPWM(speedReferenceLeft) + KP_SPEED * speedErrorLeft,
          0, PWM_MAX, MAX_SPEED_INTEGRAL);
        speedIntegralRight = EncoderMotion::integrate(
          speedIntegralRight, speedErrorRight, dt, KI_SPEED,
          speedToPWM(speedReferenceRight) + KP_SPEED * speedErrorRight,
          0, PWM_MAX, MAX_SPEED_INTEGRAL);
        speedIntegralLeft = constrain(speedIntegralLeft,
                                      -MAX_SPEED_INTEGRAL,
                                      MAX_SPEED_INTEGRAL);
        speedIntegralRight = constrain(speedIntegralRight,
                                       -MAX_SPEED_INTEGRAL,
                                       MAX_SPEED_INTEGRAL);
        piTrimLeftPWM = (int)(KP_SPEED * speedErrorLeft)
                      + (int)(KI_SPEED * speedIntegralLeft);
        piTrimRightPWM = (int)(KP_SPEED * speedErrorRight)
                       + (int)(KI_SPEED * speedIntegralRight);
      }
      piTrimLeftPWM = constrain(piTrimLeftPWM, -PWM_MAX, PWM_MAX);
      piTrimRightPWM = constrain(piTrimRightPWM, -PWM_MAX, PWM_MAX);

      previousSpeedLeftTicks = leftTicks;
      previousSpeedRightTicks = rightTicks;
      lastSpeedUpdateMs = nowMs;
    }

    int activeSegment = min(nextSegmentToCapture,
                            activeSegmentCount - 1);
    float replayPWMTrim = USE_GYRO_ASSIST
                        ? 0.0f
                        : ENCODER_ONLY_PWM_TRIM[activeSegment];
    int feedForwardPWMLeft = speedToPWM(speedReferenceLeft);
    int feedForwardPWMRight = speedToPWM(speedReferenceRight);
    int learningBalancePWM = 0;
    if (USE_GYRO_ASSIST && commandedSpeed > 0.0f) {
      float balanceScale = constrain(targetSpeedNow / commandedSpeed,
                                     0.0f,
                                     1.0f);
      learningBalancePWM =
        (int)(LEARNING_BALANCE_PWM_AT_35_CM_S * balanceScale);
    }
    int pwmLeft = constrain(feedForwardPWMLeft + piTrimLeftPWM
                          - learningBalancePWM
                          - (int)replayPWMTrim,
                            0,
                            PWM_MAX);
    int pwmRight = constrain(feedForwardPWMRight + piTrimRightPWM
                           + learningBalancePWM
                           + (int)replayPWMTrim,
                             0,
                             PWM_MAX);

    // longrangegood หยุดล้อที่ถึงเป้าหมายแล้ว ให้อีกข้างวิ่งตามให้ครบระยะ
    if (activeForwardProfile == LONG_RANGE_PROFILE
        && nextSegmentToCapture == activeSegmentCount - 1) {
      if (leftTicks >= targetTicks) pwmLeft = 0;
      if (rightTicks >= targetTicks) pwmRight = 0;
    }

    // Boost เฉพาะก่อนล้อขวาให้ pulse แรก แล้วหยุดทันทีเมื่อเริ่มหมุน
    unsigned long sinceStartMs = millis() - startMs;
    if (rightTicks == 0 && sinceStartMs < RIGHT_START_BOOST_MS) {
      float boostRatio = 1.0f
                       - sinceStartMs / (float)RIGHT_START_BOOST_MS;
      int rightBoost = (int)(RIGHT_START_BOOST_PWM * boostRatio);
      pwmRight = constrain(pwmRight + rightBoost, 0, PWM_MAX);
    }

    // ค่าเฉลี่ย differential PWM ต่อหนึ่งล้อ: บวก = ขวาแรงกว่าซ้าย
    float appliedDifferentialPWM = (pwmRight - pwmLeft) * 0.5f;
    segmentGyroCorrectionSum[activeSegment] += appliedDifferentialPWM;
    segmentGyroSpeedCorrectionSum[activeSegment] += gyroSpeedCorrection;
    segmentLearningBalancePWMSum[activeSegment] += learningBalancePWM;
    segmentGyroCorrectionSamples[activeSegment]++;

    analogWrite(ENA, pwmLeft);
    analogWrite(ENB, pwmRight);
  }

  // เก็บเวลาตอนแตะเป้าหมายก่อนสั่งหยุด
  runTimeMs = millis() - startMs - accumulatedPauseMs;

  if (cruiseSamples > 0) {
    cruiseSpeedLeft = cruiseSpeedLeftSum / cruiseSamples;
    cruiseSpeedRight = cruiseSpeedRightSum / cruiseSamples;
  }

  // ปล่อยหยุดพร้อมกัน เพราะ dynamic brake ทำให้รถบิดหลังถึงเป้าหมาย
  Stop();
  motionSettled = waitForEncoderStop();

  Serial.println("STOPPED - DO NOT TOUCH ROBOT, MEASURING GYRO...");

  // เก็บ Yaw ระหว่างที่รถกำลังไหลหลังสั่งหยุดด้วย
  unsigned long settleStart = millis();
  while (millis() - settleStart < SETTLE_TIME_MS) {
    updateGyro();
    delay(2);
  }

  readEncoders(finalEncoderL, finalEncoderR);
  finalYaw = yaw;
  finalGyroZ = measureResidualGyroBias();
  Serial.println("MEASUREMENT COMPLETE - ROBOT CAN BE MOVED");
  testFinished = true;
}

void saveFirstStageResult() {
  firstStageResult.ready = true;
  firstStageResult.timedOut = runTimedOut;
  firstStageResult.stateNumber = movementStateNumber;
  firstStageResult.targetDistanceCM = commandedDistanceCM;
  firstStageResult.runTimeMs = runTimeMs;
  firstStageResult.yawAtStop = yawAtStopCommand;
  firstStageResult.leftAtStop = leftAtStopCommand;
  firstStageResult.rightAtStop = rightAtStopCommand;
  firstStageResult.finalLeft = finalEncoderL;
  firstStageResult.finalRight = finalEncoderR;

  float runTimeSec = runTimeMs / 1000.0f;
  if (runTimeSec > 0.0f) {
    firstStageResult.averageSpeedLeft =
      (leftAtStopCommand * CM_PER_TICK) / runTimeSec;
    firstStageResult.averageSpeedRight =
      (rightAtStopCommand * CM_PER_TICK) / runTimeSec;
  }

  firstStageResult.gyroValid = gyroReadFailuresAtStop <= 20
                            && gyroBusRecoveriesAtStop <= 2
                            && gyroInvalidSamplesAtStop <= 5
                            && gyroResidualBiasValid
                            && fabs(finalGyroZ)
                               <= MAX_VALID_RESIDUAL_BIAS;
  firstStageResult.correctedYawAtStop = yawAtStopCommand;
  if (firstStageResult.gyroValid) {
    firstStageResult.correctedYawAtStop -= finalGyroZ
      * (gyroIntegrationTimeMs / 1000.0f);
  }
}

void printFirstStageResult() {
  if (!firstStageResult.ready) return;

  Serial.println("======= SAVED STATE 1 RESULT =======");
  Serial.print("Target Distance      : ");
  Serial.print(firstStageResult.targetDistanceCM, 1);
  Serial.println(" cm");
  Serial.print("Run time             : ");
  Serial.print(firstStageResult.runTimeMs);
  Serial.println(" ms");
  Serial.print("Run Timed Out        : ");
  Serial.println(firstStageResult.timedOut ? "YES" : "NO");
  Serial.print("Gyro Data Status     : ");
  Serial.println(firstStageResult.gyroValid ? "VALID" : "INVALID");
  Serial.print("Yaw at stop          : ");
  Serial.print(firstStageResult.yawAtStop, 3);
  Serial.println(" deg");
  if (firstStageResult.gyroValid) {
    Serial.print("Corrected Yaw        : ");
    Serial.print(firstStageResult.correctedYawAtStop, 3);
    Serial.println(" deg");
  }
  Serial.print("L/R at stop          : ");
  Serial.print(firstStageResult.leftAtStop);
  Serial.print(" / ");
  Serial.println(firstStageResult.rightAtStop);
  Serial.print("Final L/R            : ");
  Serial.print(firstStageResult.finalLeft);
  Serial.print(" / ");
  Serial.println(firstStageResult.finalRight);
  Serial.print("Distance L/R         : ");
  Serial.print(firstStageResult.finalLeft * CM_PER_TICK, 2);
  Serial.print(" / ");
  Serial.print(firstStageResult.finalRight * CM_PER_TICK, 2);
  Serial.println(" cm");
  Serial.print("Average Speed L/R    : ");
  Serial.print(firstStageResult.averageSpeedLeft, 2);
  Serial.print(" / ");
  Serial.print(firstStageResult.averageSpeedRight, 2);
  Serial.println(" cm/s");
  Serial.println("====================================");
}

// =====================================================
// PRINT ROTATION RESULT
// =====================================================
void printRotationResult() {
  bool gyroBiasStable = gyroResidualBiasValid
                     && fabs(finalGyroZ) <= MAX_VALID_RESIDUAL_BIAS;
  bool gyroDataReliable = gyroReadFailuresAtStop <= 20
                       && gyroBusRecoveriesAtStop <= 2
                       && gyroInvalidSamplesAtStop <= 5
                       && gyroBiasStable;
  float correctedYawAtStop = yawAtStopCommand
                           - finalGyroZ
                           * (gyroIntegrationTimeMs / 1000.0f);
  float correctedFinalYaw = finalYaw
                          - finalGyroZ
                          * ((gyroIntegrationTimeMs + SETTLE_TIME_MS)
                             / 1000.0f);
  float expectedGyroYaw = RIGHT_TURN_GYRO_SIGN
                        * commandedRotationDirection
                        * commandedRotationDeg;
  float finalRotationProgress = RIGHT_TURN_GYRO_SIGN
                              * commandedRotationDirection
                              * correctedFinalYaw;
  float finalAngleError = finalRotationProgress - commandedRotationDeg;
  float measuredFinalAngle = fabs(correctedFinalYaw);
  float angleScale = measuredFinalAngle > 1.0f
                   ? commandedRotationDeg / measuredFinalAngle
                   : 1.0f;
  float recommendedLeftTicks = leftAtStopCommand * angleScale;
  float recommendedRightTicks = rightAtStopCommand * angleScale;
  float allowedAngleError = max(2.0f, commandedRotationDeg * 0.01f);
  bool rotationCalibrationReady = gyroDataReliable
                               && !runTimedOut
                               && !rotationAbortedGyro
                               && !rotationAbortedWrongDirection
                               && !rotationAbortedWheelStart
                               && !rotationAbortedWheelMismatch
                               && fabs(finalAngleError) <= allowedAngleError;
  bool encoderTargetReached = leftAtStopCommand >= rotationTargetLeftTicks
                           && rightAtStopCommand >= rotationTargetRightTicks;

  Serial.println("======= ROTATION TEST RESULT =======");
  Serial.print("Firmware             : ");
  Serial.println(FIRMWARE_REVISION);
  Serial.print("Control Mode         : ");
  Serial.println(rotationEncoderReplayMode
               ? "ENCODER-ONLY ROTATION (GYRO LOG ONLY)"
               : "GYRO 360 STOP + ENCODER COUNT");
  Serial.print("Direction            : ");
  Serial.println(commandedRotationDirection > 0 ? "RIGHT" : "LEFT");
  Serial.print("Target Angle         : ");
  Serial.print(commandedRotationDeg, 2);
  Serial.println(" deg");
  Serial.print("Expected Gyro Yaw    : ");
  Serial.print(expectedGyroYaw, 2);
  Serial.println(" deg");
  if (rotationEncoderReplayMode) {
    Serial.print("Encoder Target L/R   : ");
    Serial.print(rotationTargetLeftTicks);
    Serial.print(" / ");
    Serial.println(rotationTargetRightTicks);
    Serial.print("Target Wheel Speed   : ");
    Serial.print(commandedSpeed, 2);
    Serial.println(" cm/s");
  }
  Serial.print("Run time             : ");
  Serial.print(runTimeMs);
  Serial.println(" ms");
  Serial.print("Run Timed Out        : ");
  Serial.println(runTimedOut ? "YES" : "NO");
  Serial.print("Rotation Status      : ");
  if (rotationAbortedGyro) {
    Serial.println("ABORTED - GYRO UNSAFE");
  } else if (rotationAbortedWheelStart) {
    Serial.println("ABORTED - WHEEL DID NOT START");
  } else if (rotationAbortedWheelMismatch) {
    Serial.println("ABORTED - ONE WHEEL FAILED TO FINISH");
  } else if (rotationAbortedWrongDirection) {
    Serial.println("ABORTED - WRONG DIRECTION");
  } else if (runTimedOut) {
    Serial.println("ABORTED - TIMEOUT");
  } else if (rotationEncoderReplayMode && encoderTargetReached) {
    Serial.println("COMPLETE - ENCODER TARGET REACHED");
  } else if (rotationCalibrationReady) {
    Serial.println("COMPLETE - TICKS READY");
  } else {
    Serial.println("COMPLETE - ADJUST FROM RESULT");
  }
  Serial.print("First Pulse Left     : ");
  Serial.print(firstLeftTickMs);
  Serial.println(" ms");
  Serial.print("First Pulse Right    : ");
  Serial.print(firstRightTickMs);
  Serial.println(" ms");
  Serial.print("Cruise Speed Left    : ");
  Serial.print(cruiseSpeedLeft, 2);
  Serial.println(" cm/s");
  Serial.print("Cruise Speed Right   : ");
  Serial.print(cruiseSpeedRight, 2);
  Serial.println(" cm/s");
  Serial.print("Yaw at stop command  : ");
  Serial.print(yawAtStopCommand, 3);
  Serial.println(" deg");
  Serial.print("Predicted stop Yaw   : ");
  Serial.print(predictedYawAtStop, 3);
  Serial.println(" deg");
  Serial.print("Final Yaw after stop : ");
  Serial.print(finalYaw, 3);
  Serial.println(" deg");
  Serial.print("Corrected Yaw at stop: ");
  Serial.print(correctedYawAtStop, 3);
  Serial.println(" deg");
  Serial.print("Corrected Final Yaw  : ");
  Serial.print(correctedFinalYaw, 3);
  Serial.println(" deg");
  Serial.print("Final Turn Progress  : ");
  Serial.print(finalRotationProgress, 3);
  Serial.println(" deg");
  Serial.print("Final Angle Error    : ");
  Serial.print(finalAngleError, 3);
  Serial.println(" deg");
  Serial.print("Max Rotation Rate    : ");
  Serial.print(maxAbsRotationRate, 2);
  Serial.println(" deg/s");
  Serial.print("Final Gyro Z         : ");
  Serial.print(finalGyroZ, 3);
  Serial.println(" deg/s (residual bias)");
  Serial.print("Gyro Read Failures   : ");
  Serial.println(gyroReadFailures);
  Serial.print("Gyro Bus Recoveries  : ");
  Serial.println(gyroBusRecoveries);
  Serial.print("Gyro Invalid Samples : ");
  Serial.println(gyroInvalidSamples);
  Serial.print("Gyro Data Status     : ");
  Serial.println(gyroDataReliable ? "VALID" : "INVALID - DO NOT CALIBRATE");
  Serial.print("L/R at stop command  : ");
  Serial.print(leftAtStopCommand);
  Serial.print(" / ");
  Serial.println(rightAtStopCommand);
  Serial.print("Final Encoder L/R    : ");
  Serial.print(finalEncoderL);
  Serial.print(" / ");
  Serial.println(finalEncoderR);
  Serial.print("Wheel travel L/R     : ");
  Serial.print(leftAtStopCommand * CM_PER_TICK, 2);
  Serial.print(" / ");
  Serial.print(rightAtStopCommand * CM_PER_TICK, 2);
  Serial.println(" cm");
  Serial.print("Recommended stop L/R: ");
  Serial.print(recommendedLeftTicks, 2);
  Serial.print(" / ");
  Serial.print(recommendedRightTicks, 2);
  Serial.println(" ticks");
  if (gyroDataReliable && measuredFinalAngle > 1.0f) {
    Serial.print("Estimated 90deg L/R : ");
    Serial.print(leftAtStopCommand * 90.0f / measuredFinalAngle, 2);
    Serial.print(" / ");
    Serial.print(rightAtStopCommand * 90.0f / measuredFinalAngle, 2);
    Serial.println(" ticks");
    Serial.print("Estimated 360deg L/R: ");
    Serial.print(leftAtStopCommand * 360.0f / measuredFinalAngle, 2);
    Serial.print(" / ");
    Serial.print(rightAtStopCommand * 360.0f / measuredFinalAngle, 2);
    Serial.println(" ticks");
  }
  Serial.println("====================================");
}

// =====================================================
// PRINT FORWARD RESULT
// =====================================================
void printResult() {
  long encoderDiff = (long)finalEncoderL - (long)finalEncoderR;
  float runTimeSec = runTimeMs / 1000.0f;
  float averageSpeedLeft = 0.0f;
  float averageSpeedRight = 0.0f;

  if (runTimeSec > 0.0f) {
    // ใช้ค่าตอนสั่งหยุด เพื่อไม่รวมระยะที่ล้อไหลหลังตัดกำลัง
    averageSpeedLeft = (leftAtStopCommand * CM_PER_TICK) / runTimeSec;
    averageSpeedRight = (rightAtStopCommand * CM_PER_TICK) / runTimeSec;
  }

  Serial.println("========== TEST RESULT ==========");
  Serial.print("Firmware             : ");
  Serial.println(FIRMWARE_REVISION);

  Serial.print("Movement State       : ");
  Serial.println(movementStateNumber);

  Serial.print("Target Distance      : ");
  Serial.print(commandedDistanceCM, 1);
  Serial.println(" cm");

  Serial.print("Control Mode         : ");
  Serial.println(USE_GYRO_ASSIST
                 ? "GYRO LEARNING"
                 : "ENCODER-ONLY REPLAY");

  Serial.print("Encoder Counts/Rev   : ");
  Serial.println(ENCODER_COUNTS_PER_REV, 0);

  Serial.print("CM per Count         : ");
  Serial.println(CM_PER_TICK, 3);

  Serial.print("Run time             : ");
  Serial.print(runTimeMs);
  Serial.println(" ms");

  Serial.print("Run Timed Out        : ");
  Serial.println(runTimedOut ? "YES" : "NO");

  Serial.print("Target Cruise Speed  : ");
  Serial.print(commandedSpeed, 2);
  Serial.println(" cm/s");

  Serial.print("First Pulse Left     : ");
  Serial.print(firstLeftTickMs);
  Serial.println(" ms");

  Serial.print("First Pulse Right    : ");
  Serial.print(firstRightTickMs);
  Serial.println(" ms");
  Serial.println("First pulse timing depends on encoder slot phase");

  Serial.print("Cruise Speed Left    : ");
  Serial.print(cruiseSpeedLeft, 2);
  Serial.println(" cm/s");

  Serial.print("Cruise Speed Right   : ");
  Serial.print(cruiseSpeedRight, 2);
  Serial.println(" cm/s");

  Serial.print("Yaw at stop command  : ");
  Serial.print(yawAtStopCommand, 3);
  Serial.println(" deg");

  Serial.print("Final Yaw after stop : ");
  Serial.print(finalYaw, 3);
  Serial.println(" deg");

  Serial.print("Final Gyro Z         : ");
  Serial.print(finalGyroZ, 3);
  Serial.println(" deg/s (residual bias)");

  Serial.print("Gyro Read Failures   : ");
  Serial.println(gyroReadFailures);

  Serial.print("Gyro Retry Successes : ");
  Serial.println(gyroRetrySuccesses);

  Serial.print("Gyro Bus Recoveries  : ");
  Serial.println(gyroBusRecoveries);

  Serial.print("Gyro Invalid Samples : ");
  Serial.println(gyroInvalidSamples);

  Serial.print("Residual Rejected    : ");
  Serial.println(gyroResidualRejectedSamples);

  Serial.print("Failures At Stop     : ");
  Serial.println(gyroReadFailuresAtStop);

  Serial.print("Recoveries At Stop   : ");
  Serial.println(gyroBusRecoveriesAtStop);

  Serial.print("Invalid At Stop      : ");
  Serial.println(gyroInvalidSamplesAtStop);

  Serial.print("Gyro Found At Boot   : ");
  Serial.println(gyroAvailable ? "YES" : "NO");

  Serial.print("Gyro Disabled In Run : ");
  Serial.println(gyroDisabledForRun ? "YES" : "NO");

  Serial.print("Residual Bias Read   : ");
  Serial.println(gyroResidualBiasValid ? "VALID" : "FAILED");

  bool gyroBiasStable = gyroResidualBiasValid
                     && fabs(finalGyroZ) <= MAX_VALID_RESIDUAL_BIAS;
  bool gyroDataReliable = gyroReadFailuresAtStop <= 20
                       && gyroBusRecoveriesAtStop <= 2
                       && gyroInvalidSamplesAtStop <= 5
                       && gyroBiasStable;
  float correctedYawAtStop = yawAtStopCommand
                           - finalGyroZ
                           * (gyroIntegrationTimeMs / 1000.0f);
  float correctedFinalYaw = finalYaw
                          - finalGyroZ
                          * ((gyroIntegrationTimeMs + SETTLE_TIME_MS)
                             / 1000.0f);
  float learningPeakYaw = 0.0f;
  float learningSideOffsetCM = 0.0f;
  float previousLearningYaw = 0.0f;
  for (int i = 0; i < capturedSegmentCount; i++) {
    if (segmentMaxAbsYaw[i] > learningPeakYaw) {
      learningPeakYaw = segmentMaxAbsYaw[i];
    }
    float checkpointYaw = segmentYaw[i]
                        - finalGyroZ * segmentTimeSec[i];
    float averageHeadingDeg =
      (previousLearningYaw + checkpointYaw) * 0.5f;
    float segmentDistanceCM =
      (segmentEncoderL[i] + segmentEncoderR[i])
      * 0.5f * CM_PER_TICK;
    learningSideOffsetCM += segmentDistanceCM
                          * sin(averageHeadingDeg * PI / 180.0f);
    previousLearningYaw = checkpointYaw;
  }
  bool learningMotionComplete = !runTimedOut
                             && !straightStalled && motionSettled
                             && !learningAbortedGyro
                             && !learningAbortedYawLimit
                             && capturedSegmentCount == activeSegmentCount;
  bool learningTrajectoryGood = learningPeakYaw <= MAX_TABLE_PEAK_YAW_DEG
                             && fabs(correctedYawAtStop)
                                <= MAX_TABLE_FINAL_YAW_DEG
                             && fabs(learningSideOffsetCM)
                                <= MAX_TABLE_SIDE_OFFSET_CM;
  bool learningDataUsable = USE_GYRO_ASSIST
                         && learningMotionComplete
                         && gyroDataReliable
                         && learningTrajectoryGood;

  Serial.print("Gyro Bias Status     : ");
  Serial.println(gyroBiasStable ? "STABLE" : "SHIFTED - DO NOT CORRECT YAW");

  Serial.print("Gyro Data Status     : ");
  Serial.println(gyroDataReliable ? "VALID" : "INVALID - DO NOT CALIBRATE");

  if (USE_GYRO_ASSIST) {
    Serial.print("Learning Status      : ");
    if (learningAbortedGyro) {
      Serial.println("ABORTED - GYRO UNSAFE");
    } else if (learningAbortedYawLimit) {
      Serial.println("ABORTED - YAW LIMIT");
    } else if (runTimedOut) {
      Serial.println("ABORTED - TIMEOUT");
    } else if (!learningMotionComplete) {
      Serial.println("INCOMPLETE");
    } else if (!gyroDataReliable) {
      Serial.println("INVALID - DO NOT SAVE TABLE");
    } else if (!learningTrajectoryGood) {
      Serial.println("RETRY - TRAJECTORY OUT OF LIMIT");
    } else {
      Serial.println("COMPLETE - TABLE READY");
    }
    Serial.print("Learning Peak Yaw    : ");
    Serial.print(learningPeakYaw, 3);
    Serial.println(" deg");
    Serial.print("Learning Side Offset : ");
    Serial.print(learningSideOffsetCM, 2);
    Serial.println(" cm");
  }

  if (gyroDataReliable) {
    Serial.print("Corrected Yaw at stop: ");
    Serial.print(correctedYawAtStop, 3);
    Serial.println(" deg");

    Serial.print("Corrected Final Yaw  : ");
    Serial.print(correctedFinalYaw, 3);
    Serial.println(" deg");
  }

  Serial.print("L/R at stop command  : ");
  Serial.print(leftAtStopCommand);
  Serial.print(" / ");
  Serial.println(rightAtStopCommand);

  if (USE_GYRO_ASSIST) {
    Serial.print("Learned R-L at stop : ");
    Serial.print((long)rightAtStopCommand - (long)leftAtStopCommand);
    Serial.println(" ticks (cumulative)");
  }

  Serial.print("Average Speed Left   : ");
  Serial.print(averageSpeedLeft, 2);
  Serial.println(" cm/s");

  Serial.print("Average Speed Right  : ");
  Serial.print(averageSpeedRight, 2);
  Serial.println(" cm/s");

  Serial.print("Encoder settle status: ");
  Serial.println(motionSettled ? "QUIET" : "TIMEOUT");
  Serial.print("Straight stall      : ");
  Serial.println(straightStalled ? "YES" : "NO");
  Serial.print("Final Encoder Left   : ");
  Serial.println(finalEncoderL);

  Serial.print("Final Encoder Right  : ");
  Serial.println(finalEncoderR);

  Serial.print("Distance Left        : ");
  Serial.print(finalEncoderL * CM_PER_TICK, 2);
  Serial.println(" cm");

  Serial.print("Distance Right       : ");
  Serial.print(finalEncoderR * CM_PER_TICK, 2);
  Serial.println(" cm");

  Serial.print("Encoder Diff L-R     : ");
  Serial.println(encoderDiff);

  float finalAverageDistance = (finalEncoderL + finalEncoderR)
                             * 0.5f * CM_PER_TICK;
  Serial.print("Target Diff R-L      : ");
  if (USE_GYRO_ASSIST) {
    Serial.println("LEARNING - NOT USED");
  } else {
    Serial.print(desiredRightExtraTicks(finalAverageDistance), 3);
    Serial.println(" ticks");
    Serial.print("Configured R-L table : { ");
    for (int i = 0; i < activeSegmentCount; i++) {
      Serial.print(encoderTargetForSegment(i), 1);
      if (i < activeSegmentCount - 1) Serial.print(", ");
    }
    Serial.println(" }");
  }

  Serial.println("----- DISTANCE SEGMENT LOG -----");
  if (!gyroDataReliable || capturedSegmentCount == 0) {
    Serial.println("SKIPPED: No reliable Gyroscope checkpoints");
  } else {
    float previousCorrectedYaw = 0.0f;
    float lateralOffsetCM = 0.0f;
    for (int i = 0; i < capturedSegmentCount; i++) {
      float correctedYaw = segmentYaw[i]
                         - finalGyroZ * segmentTimeSec[i];
      float deltaYaw = correctedYaw - previousCorrectedYaw;

      // ประมาณระยะเยื้องข้างจาก heading เฉลี่ยและระยะจริงของช่วงนั้น
      // เครื่องหมายบอกทิศตามเครื่องหมายของ Yaw
      float averageHeadingDeg = (previousCorrectedYaw + correctedYaw) * 0.5f;
      float actualSegmentDistanceCM =
        (segmentEncoderL[i] + segmentEncoderR[i])
        * 0.5f * CM_PER_TICK;
      lateralOffsetCM += actualSegmentDistanceCM
                       * sin(averageHeadingDeg * PI / 180.0f);

      long segmentDiff = (long)segmentEncoderR[i]
                       - (long)segmentEncoderL[i];
      long cumulativeDiff = (long)checkpointEncoderR[i]
                          - (long)checkpointEncoderL[i];

      float averageGyroCorrection = 0.0f;
      float averageGyroSpeedCorrection = 0.0f;
      float averageLearningBalancePWM = 0.0f;
      if (segmentGyroCorrectionSamples[i] > 0) {
        averageGyroCorrection = segmentGyroCorrectionSum[i]
                              / segmentGyroCorrectionSamples[i];
        averageGyroSpeedCorrection = segmentGyroSpeedCorrectionSum[i]
                                   / segmentGyroCorrectionSamples[i];
        averageLearningBalancePWM = segmentLearningBalancePWMSum[i]
                                  / segmentGyroCorrectionSamples[i];
      }

      // การชดเชยเชิงเรขาคณิต: R-L = trackWidth * yaw(rad)
      // รายงานต่อความกว้างฐานล้อ 1 cm ก่อน เพื่อไม่เดาขนาดตัวรถ
      float correctionTicksPerTrackCM =
        (correctedYaw * PI / 180.0f) / CM_PER_TICK;

      Serial.print("Segment ");
      Serial.print(i + 1);
      Serial.print(" | Checkpoint: ");
      float checkpointCM = min(commandedDistanceCM,
                               (i + 1) * CALIBRATION_SEGMENT_CM);
      Serial.print(checkpointCM, 1);
      Serial.print(" cm | Segment distance: ");
      Serial.print(actualSegmentDistanceCM, 1);
      Serial.print(" cm");
      Serial.print(" | From start: ");
      Serial.print(correctedYaw, 3);
      Serial.print(" deg | This segment: ");
      Serial.print(deltaYaw, 3);
      Serial.print(" deg | Max abs yaw: ");
      Serial.print(segmentMaxAbsYaw[i], 3);
      Serial.print(" deg | End gyro Z: ");
      Serial.print(segmentGyroRateAtCheckpoint[i], 3);
      Serial.print(" deg/s | Side offset: ");
      Serial.print(lateralOffsetCM, 2);
      Serial.print(" cm | Segment R-L: ");
      Serial.print(segmentDiff);
      Serial.print(" ticks | Cumulative R-L: ");
      Serial.print(cumulativeDiff);
      Serial.print(" ticks | Avg gyro speed +/-: ");
      Serial.print(averageGyroSpeedCorrection, 3);
      Serial.print(" cm/s | Avg balance PWM/side: ");
      Serial.print(averageLearningBalancePWM, 1);
      Serial.print(" | Avg total diff PWM/side: ");
      Serial.print(averageGyroCorrection, 1);
      Serial.print(" | Need R-L per track-cm: ");
      Serial.print(correctionTicksPerTrackCM, 5);
      Serial.println(" ticks");

      previousCorrectedYaw = correctedYaw;
    }

    if (learningDataUsable) {
      Serial.println("----- ENCODER-ONLY REPLAY TABLE -----");
      Serial.print("const float LEARNED_R_MINUS_L[");
      Serial.print(activeSegmentCount);
      Serial.print("] = { ");
      for (int i = 0; i < activeSegmentCount; i++) {
        long learnedDiff = (long)checkpointEncoderR[i]
                         - (long)checkpointEncoderL[i];
        Serial.print((float)learnedDiff, 1);
        if (i < activeSegmentCount - 1) Serial.print(", ");
      }
      Serial.println(" };");
      Serial.println("Use this cumulative R-L table for replay; keep PWM trim at zero");
    } else if (USE_GYRO_ASSIST) {
      Serial.println("LEARNED TABLE SKIPPED: Check Learning Status above");
    }
  }
  Serial.println("=================================");
}

// =====================================================
// COMBINED SETUP / LOOP
// =====================================================
const float SHORT_PATH_DISTANCE_CM = 400.0f;
const float LONG_RANGE_DISTANCE_CM = 500.0f;
const float COMBINED_FORWARD_SPEED_CM_S = 50.0f;
const float FINAL_LEFT_TURN_DEG = ROTATE_TARGET_DEG;
const int FINAL_LEFT_TURN_DIRECTION = -1;
const unsigned long COMBINED_STATE_PAUSE_MS = 500UL;
const int COMBINED_STATE_COUNT = 4;
// 0 = existing full sequence; 1 = one forward test; 2 = right turn; 3 = left turn.
// Start field validation with mode 1, then 2/3. This firmware does not implement reverse.
const int ENCODER_TEST_MODE = 0;
const float ENCODER_TEST_DISTANCE_CM = 100.0f;
const float ENCODER_TEST_SPEED_CM_S = 25.0f;
const float ENCODER_TEST_TURN_DEG = 90.0f;

void initializeCombinedHardware() {
  pinMode(ENA, OUTPUT);
  pinMode(IN1, OUTPUT);
  pinMode(IN2, OUTPUT);
  pinMode(ENB, OUTPUT);
  pinMode(IN3, OUTPUT);
  pinMode(IN4, OUTPUT);

  pinMode(ENC_R, INPUT);
  pinMode(ENC_L, INPUT);

  analogWriteResolution(12);

  attachInterrupt(digitalPinToInterrupt(ENC_R), ISR_encoderR, CHANGE);
  attachInterrupt(digitalPinToInterrupt(ENC_L), ISR_encoderL, CHANGE);

  Stop();

  // ใช้ Encoder อย่างเดียว: ไม่เริ่มต้นและไม่อ่าน MPU6050
  gyroAvailable = false;
  gyroDisabledForRun = true;
}

bool runCombinedForwardState(int stateNumber,
                             const char *stateName,
                             float distanceCM,
                             ForwardProfile profile) {
  movementStateNumber = stateNumber;
  activeForwardProfile = profile;
  Serial.println();
  Serial.print("CURRENT STATE ");
  Serial.print(stateNumber);
  Serial.print("/");
  Serial.print(COMBINED_STATE_COUNT);
  Serial.print(": ");
  Serial.print(stateName);
  Serial.print(" | target ");
  Serial.print(distanceCM, 1);
  Serial.print(" cm = ");
  Serial.print(distanceCM / 100.0f, 2);
  Serial.println(" m");

  motionSettled = true;
  forwardClosedLoop(COMBINED_FORWARD_SPEED_CM_S, distanceCM);
  printResult();
  if (runTimedOut || straightStalled || !motionSettled || learningAbortedGyro || learningAbortedYawLimit) {
    Stop();
    Serial.println("STATE FAILED - ROUTE ABORTED");
    return false;
  }

  Serial.print("STATE ");
  Serial.print(stateNumber);
  Serial.print("/");
  Serial.print(COMBINED_STATE_COUNT);
  Serial.println(" COMPLETE");
  return true;
}

bool runCombinedRotationState(int stateNumber,
                              const char *stateName,
                              float targetDeg,
                              int direction) {
  movementStateNumber = stateNumber;
  Serial.println();
  Serial.print("CURRENT STATE ");
  Serial.print(stateNumber);
  Serial.print("/");
  Serial.print(COMBINED_STATE_COUNT);
  Serial.print(": ");
  Serial.print(stateName);
  Serial.print(" | target ");
  Serial.print(targetDeg, 1);
  Serial.print(" deg | direction ");
  Serial.println(direction > 0 ? "RIGHT" : "LEFT");

  motionSettled = true;
  if (ROTATE_USE_GYRO_LEARNING) {
    rotateGyroMeasureEncoder(targetDeg, direction);
  } else {
    rotateEncoderReplay(targetDeg, direction);
  }
  printRotationResult();
  if (runTimedOut || !motionSettled || rotationAbortedGyro || rotationAbortedWrongDirection
      || rotationAbortedWheelStart || rotationAbortedWheelMismatch) {
    Stop();
    Serial.println("STATE FAILED - ROUTE ABORTED");
    return false;
  }
  Serial.print("STATE ");
  Serial.print(stateNumber);
  Serial.print("/");
  Serial.print(COMBINED_STATE_COUNT);
  Serial.println(" COMPLETE");
  return true;
}

void pauseBeforeNextState(int completedState) {
  Stop();
  Serial.print("PAUSE AFTER STATE ");
  Serial.print(completedState);
  Serial.println(": 0.5 SECOND BEFORE NEXT STATE");
  delay(COMBINED_STATE_PAUSE_MS);
}

void printCombinedStatePlan() {
  Serial.println("STATE PLAN (distance unit: cm and m)");
  Serial.print("  FORWARD SPEED: ");
  Serial.print(COMBINED_FORWARD_SPEED_CM_S, 1);
  Serial.println(" cm/s");
  Serial.print("  STATE 1/4: shortpathgood | ");
  Serial.print(SHORT_PATH_DISTANCE_CM, 1);
  Serial.print(" cm = ");
  Serial.print(SHORT_PATH_DISTANCE_CM / 100.0f, 2);
  Serial.println(" m");
  Serial.print("  STATE 2/4: turnright360good | ");
  Serial.print(ROTATE_TARGET_DEG, 1);
  Serial.print(" deg | ");
  Serial.println(ROTATE_DIRECTION > 0 ? "RIGHT" : "LEFT");
  Serial.print("  STATE 3/4: longrangegood | ");
  Serial.print(LONG_RANGE_DISTANCE_CM, 1);
  Serial.print(" cm = ");
  Serial.print(LONG_RANGE_DISTANCE_CM / 100.0f, 2);
  Serial.println(" m");
  Serial.print("  STATE 4/4: final left turn | ");
  Serial.print(FINAL_LEFT_TURN_DEG, 1);
  Serial.println(" deg | LEFT");
}

void setup() {
  Serial.begin(115200);
  Serial.print("FIRMWARE: ");
  Serial.println(FIRMWARE_REVISION);
  Serial.println("PROFILE CHANGED: REVALIDATE CALIBRATION BEFORE FULL ROUTE");
  printCombinedStatePlan();

  initializeCombinedHardware();

  if (ENCODER_TEST_MODE != 0) {
    if (ENCODER_TEST_MODE == 1) {
      activeForwardProfile = SHORT_PATH_PROFILE;
      forwardClosedLoop(ENCODER_TEST_SPEED_CM_S, ENCODER_TEST_DISTANCE_CM);
      printResult();
      Serial.println((runTimedOut || straightStalled || !motionSettled)
        ? "SINGLE TEST FAILED" : "SINGLE TEST COMPLETE");
    } else if (ENCODER_TEST_MODE == 2 || ENCODER_TEST_MODE == 3) {
      runCombinedRotationState(1, "single encoder turn", ENCODER_TEST_TURN_DEG,
                               ENCODER_TEST_MODE == 2 ? 1 : -1);
    } else Serial.println("INVALID TEST MODE");
    Stop();
    return;
  }

  if (!runCombinedForwardState(1,
                          "shortpathgood",
                          SHORT_PATH_DISTANCE_CM,
                          SHORT_PATH_PROFILE)) return;
  pauseBeforeNextState(1);

  if (!runCombinedRotationState(2,
                           "turnright360good",
                           ROTATE_TARGET_DEG,
                           ROTATE_DIRECTION)) return;
  pauseBeforeNextState(2);

  if (!runCombinedForwardState(3,
                          "longrangegood",
                          LONG_RANGE_DISTANCE_CM,
                          LONG_RANGE_PROFILE)) return;
  pauseBeforeNextState(3);

  if (!runCombinedRotationState(4,
                           "final left turn",
                           FINAL_LEFT_TURN_DEG,
                           FINAL_LEFT_TURN_DIRECTION)) return;
  Serial.println("ALL COMBINED STATES COMPLETE");
}

void loop() {
  // All movement states are executed once from setup().
  if (testFinished) {
    delay(1000);
  }
}
